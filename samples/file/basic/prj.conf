## CMakeLists.txt
```
# SPDX-License-Identifier: Apache-2.0

cmake_minimum_required(VERSION 3.20.0)
find_package(Zephyr REQUIRED HINTS $ENV{ZEPHYR_BASE})

project(basic C)

# The Kconfig selection of the File provider decides which composition file is compiled.
# The application source is the same for both.
if(CONFIG_CRUX_FILE_SIMULATOR)
    set(storage_source src/storage_littlefs.c)
elseif(CONFIG_CRUX_FILE_FATFS_SIMULATOR)
    set(storage_source src/storage_fatfs_ram_disk.c)
else()
    message(FATAL_ERROR "basic needs CONFIG_CRUX_FILE_SIMULATOR=y (prj.conf) or "
        "CONFIG_CRUX_FILE_FATFS_SIMULATOR=y (fatfs_ram_disk.conf)")
endif()

# The application part links the public File target only. The check fails the configure step
# if the target's build requirements (include directories, compile options, linked targets)
# name a native path, a private Crux directory or a provider target. It does not read
# #include lines.
add_library(basic_logic OBJECT src/basic.c)
target_link_libraries(basic_logic PRIVATE crux::file)
set_target_properties(basic_logic PROPERTIES
    C_STANDARD 17 C_STANDARD_REQUIRED ON C_EXTENSIONS OFF)
target_compile_options(basic_logic PRIVATE -Wall -Wextra -Werror)
crux_assert_portable_consumer(basic_logic)

# The composition part may use Zephyr and binds the File root through crux::file_zephyr, the
# composition target of the Zephyr File provider.
target_sources(app PRIVATE src/main.c ${storage_source}
    $<TARGET_OBJECTS:basic_logic>)
target_link_libraries(app PRIVATE crux::file crux::file_zephyr)
target_compile_options(app PRIVATE -Wall -Wextra -Werror)
```

## prj.conf
```kconfig
CONFIG_STD_C17=y
CONFIG_PRINTK=y
CONFIG_MAIN_STACK_SIZE=4096
CONFIG_HEAP_MEM_POOL_SIZE=4096
CONFIG_FILE_SYSTEM=y
CONFIG_FILE_SYSTEM_MKFS=y

# Default scenario (.simulator): the Crux File VFS simulator provider over LittleFS on the
# native_sim flash simulator. fatfs_ram_disk.conf switches these off and selects the other provider.
CONFIG_FLASH=y
CONFIG_FLASH_MAP=y
CONFIG_FLASH_SIMULATOR=y
CONFIG_FLASH_SIMULATOR_EXPLICIT_ERASE=y
CONFIG_FILE_SYSTEM_LITTLEFS=y
CONFIG_CRUX_FILE_SIMULATOR=y
```

## fatfs_ram_disk.conf
```kconfig
# Scenario .fatfs_ram_disk: the Crux File FatFs simulator provider on a RAM disk
# (fatfs_ram_disk.overlay). Build with
#   -DEXTRA_CONF_FILE=fatfs_ram_disk.conf -DEXTRA_DTC_OVERLAY_FILE=fatfs_ram_disk.overlay

# Switch off the default provider and its storage from prj.conf.
CONFIG_CRUX_FILE_SIMULATOR=n
CONFIG_FILE_SYSTEM_LITTLEFS=n
CONFIG_FLASH_SIMULATOR_EXPLICIT_ERASE=n
CONFIG_FLASH_SIMULATOR=n
CONFIG_FLASH_MAP=n
CONFIG_FLASH=n

# FatFs as the provider requires it: long names of at least 127 characters, reentrancy, and no
# automatic format on mount.
CONFIG_FAT_FILESYSTEM_ELM=y
CONFIG_FS_FATFS_LFN=y
CONFIG_FS_FATFS_LFN_MODE_STACK=y
CONFIG_FS_FATFS_MAX_LFN=127
CONFIG_FS_FATFS_REENTRANT=y
CONFIG_FS_FATFS_MOUNT_MKFS=n
CONFIG_CRUX_FILE_FATFS_SIMULATOR=y
```

## app.overlay
```dts
/* A 64 KiB partition of the native_sim flash simulator for the default scenario (.simulator).
 * It sits after the board's own partitions, which end at 0x100000.
 */
&flash0 {
    partitions {
        file_sample_partition: partition@100000 {
            label = "file-sample";
            reg = <0x100000 0x10000>;
        };
    };
};
```

## src/main.c
```c
#include "storage.h"
#include "basic.h"

#include <string.h>
#include <zephyr/sys/printk.h>

#define FILE_NAME "greeting.txt"

static const char greeting[] = "Hello from Crux File API!";

int main(void)
{
    /* Platform composition first: mount the volume and bind it as the File root. */
    if (storage_init() != 0) {
        printk("CRUX_FILE_WRITE_READ_FAILED step=storage\n");
        return -1;
    }

    /* From here on, only the public File API is used. */
    const size_t length = sizeof(greeting) - 1;
    size_t written = 0;
    crux_file_result_t result = write_text(FILE_NAME, greeting, length, &written);
    if (result != CRUX_FILE_OK) {
        printk("CRUX_FILE_WRITE_READ_FAILED step=write result=%d\n", (int)result);
        return -1;
    }
    printk("Wrote %u bytes to %s\n", (unsigned int)written, FILE_NAME);

    char buffer[64];
    size_t read = 0;
    result = read_text(FILE_NAME, buffer, sizeof(buffer) - 1, &read);
    if (result != CRUX_FILE_OK) {
        printk("CRUX_FILE_WRITE_READ_FAILED step=read result=%d\n", (int)result);
        return -1;
    }
    buffer[read] = '\0';
    printk("Read %u bytes: %s\n", (unsigned int)read, buffer);

    if (read != length || memcmp(buffer, greeting, length) != 0) {
        printk("CRUX_FILE_WRITE_READ_FAILED step=compare\n");
        return -1;
    }
    printk("CRUX_FILE_WRITE_READ_OK provider=%s\n", storage_provider_name);
    return 0;
}
```

## src/basic.c
```c
#include "basic.h"

crux_file_result_t write_text(const char *name, const char *text, size_t length, size_t *written)
{
    crux_file_t *file = NULL;
    *written = 0;

    crux_file_result_t result = crux_file_open(name, CRUX_FILE_CREATE_REPLACE, &file);
    if (result != CRUX_FILE_OK) {
        return result;
    }

    result = crux_file_write(file, text, length, written);
    if (result == CRUX_FILE_OK) {
        /* A write alone implies nothing about storage; sync asks the provider to flush it. */
        result = crux_file_sync(file);
    }

    /* Close always consumes the handle. Report the first failure. */
    const crux_file_result_t closed = crux_file_close(&file);
    return result != CRUX_FILE_OK ? result : closed;
}

crux_file_result_t read_text(const char *name, char *buffer, size_t capacity, size_t *length)
{
    crux_file_t *file = NULL;
    *length = 0;

    crux_file_result_t result = crux_file_open(name, CRUX_FILE_READ, &file);
    if (result != CRUX_FILE_OK) {
        return result;
    }

    result = crux_file_read(file, buffer, capacity, length);

    const crux_file_result_t closed = crux_file_close(&file);
    return result != CRUX_FILE_OK ? result : closed;
}
```

## src/basic.h
```c
#ifndef FILE_BASIC_H
#define FILE_BASIC_H

/*
 * The application part of the sample. It uses only the public File API (<crux/file.h>) and does
 * not know which provider or file system the build selected.
 */

#include <crux/file.h>

#include <stddef.h>

/**
 * Create or replace a file and write a text to it.
 *
 * @param name Flat file name in the default File root.
 * @param text Bytes to write.
 * @param length Number of bytes in text.
 * @param[out] written Bytes the provider accepted.
 * @return CRUX_FILE_OK when every byte was written and flushed, otherwise the first failure.
 */
crux_file_result_t write_text(const char *name, const char *text, size_t length, size_t *written);

/**
 * Read a file from its start into a buffer.
 *
 * @param name Flat file name in the default File root.
 * @param[out] buffer Destination.
 * @param capacity Size of buffer in bytes.
 * @param[out] length Bytes read; at most capacity.
 * @return CRUX_FILE_OK or the first failure.
 */
crux_file_result_t read_text(const char *name, char *buffer, size_t capacity, size_t *length);

#endif
```

## src/storage.h
```c
#ifndef FILE_BASIC_STORAGE_H
#define FILE_BASIC_STORAGE_H

/*
 * The platform composition of the sample: it mounts a file system and binds it as the default
 * File root. The build compiles exactly one implementation, chosen by the selected File
 * provider (CMakeLists.txt). Application code never calls Zephyr's file system API itself.
 */

/** Short name of the selected provider, printed in the result line. */
extern const char *const storage_provider_name;

/**
 * Mount the volume and bind it as File root 0. Prints one "Storage: ..." line.
 *
 * @return 0 on success, otherwise a negative value.
 */
int storage_init(void);

#endif
```
