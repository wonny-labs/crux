## sample.yaml
```
sample:
  name: Hello Crux
  description: >-
    The smallest Zephyr application that uses Crux. It links the base target of the Crux
    module, prints the Crux version from its public header and prints a ready line.
# Twister adds list keys of a scenario to those of this section instead of replacing them,
# so the platforms and tags are set per scenario.
tests:
  crux.sample.hello_crux:
    tags: [crux, sample]
    platform_allow:
      - native_sim/native/64
    integration_platforms:
      - native_sim/native/64
    harness: console
    harness_config:
      type: multi_line
      ordered: true
      regex:
        - "Hello from Crux \\S+ on zephyr"
        - "CRUX_HELLO_READY composition=zephyr"
  # Build only: the same application cross-built for the EVKB. No board result is recorded for it.
  # It has no `sample` tag, so `-t sample` keeps selecting only what runs on native_sim.
  crux.sample.hello_crux.evkb:
    tags: [crux, link_only]
    build_only: true
    platform_allow:
      - mimxrt1060_evk@B/mimxrt1062/qspi
    integration_platforms:
      - mimxrt1060_evk@B/mimxrt1062/qspi
```

## prj.conf
```kconfig
CONFIG_STD_C17=y
CONFIG_PRINTK=y
```

## src/main.c
```c
#include <crux/version.h>

#include <zephyr/sys/printk.h>

int main(void)
{
    printk("Hello from Crux %s on zephyr\n", CRUX_VERSION_STRING);
    printk("CRUX_HELLO_READY composition=zephyr\n");
    return 0;
}
```
