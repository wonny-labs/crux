## CMakeLists.txt
```
# SPDX-License-Identifier: Apache-2.0

cmake_minimum_required(VERSION 3.20.0)
# The Crux module comes from the west workspace, like any other Zephyr module. Its Kconfig
# symbols (CONFIG_CRUX_*) select what it builds; crux::base always exists.
find_package(Zephyr REQUIRED HINTS $ENV{ZEPHYR_BASE})

project(hello_crux C)

target_sources(app PRIVATE src/main.c)
# The application links the public usage target only: no Crux source, port or private
# include directory.
target_link_libraries(app PRIVATE crux::base)
target_compile_options(app PRIVATE -Wall -Wextra -Werror)
```

## sample.yaml
```
sample:
  name: Hello Crux
  description: >-
    The smallest Zephyr application that uses Crux. It links the Time target of the Crux
    module, makes one public call and prints a ready line.
# Twister adds list keys of a scenario to those of this section instead of replacing them,
# so the platforms and tags are set per scenario.
tests:
  crux.sample.hello_crux:
    tags: [crux, sample, time]
    platform_allow:
      - native_sim/native/64
    integration_platforms:
      - native_sim/native/64
    harness: console
    harness_config:
      type: multi_line
      ordered: true
      regex:
        - "Hello from Crux on zephyr"
        - "Crux Time: unset"
        - "CRUX_HELLO_READY composition=zephyr"
  # Build only: the same application cross-built for the EVKB. No board result is recorded for it.
  # It has no `sample` tag, so `-t sample` keeps selecting only what runs on native_sim.
  crux.sample.hello_crux.evkb:
    tags: [crux, time, link_only]
    build_only: true
    platform_allow:
      - mimxrt1060_evk@B/mimxrt1062/qspi
    integration_platforms:
      - mimxrt1060_evk@B/mimxrt1062/qspi
```

## prj.conf
```kconfig
CONFIG_STD_C17=y
# Build Crux Time from the Crux module. Its Zephyr provider uses the system clock and needs no RTC.
CONFIG_CRUX_TIME=y
CONFIG_PRINTK=y
```

## src/main.c
```c
#include "hello_crux.h"

#include <zephyr/sys/printk.h>

int main(void)
{
    printk("Hello from Crux on zephyr\n");

    const char *state = hello_crux_time_state();
    if (state == NULL) {
        printk("CRUX_HELLO_FAILED composition=zephyr\n");
        return -1;
    }

    printk("Crux Time: %s\n", state);
    printk("CRUX_HELLO_READY composition=zephyr\n");
    return 0;
}
```

## src/hello_crux.c
```c
#include "hello_crux.h"

#include <crux/status.h>
#include <crux/time.h>

#include <stddef.h>

const char *hello_crux_time_state(void)
{
    if (crux_realtime_init() != CRUX_OK) {
        return NULL;
    }

    /* Initialisation leaves the clock ready but unset: Crux never invents a time of day. */
    crux_realtime_t now;
    const crux_status_t status = crux_realtime_now(&now);
    if (status == CRUX_ERR_NO_DATA) {
        return "unset";
    }
    return status == CRUX_OK ? "set" : NULL;
}
```

## src/hello_crux.h
```c
#ifndef HELLO_CRUX_H
#define HELLO_CRUX_H

/*
 * The portable part of the sample. It uses only the public Crux API (<crux/time.h>), so the
 * Zephyr application and the Linux Host program compile the same file.
 */

/**
 * Prepare Crux Time and describe its realtime clock in one word.
 *
 * @return "unset" when no realtime value has been established yet (the state right after
 *         initialisation), "set" when one has, or NULL when Crux Time could not be used.
 */
const char *hello_crux_time_state(void);

#endif
```
