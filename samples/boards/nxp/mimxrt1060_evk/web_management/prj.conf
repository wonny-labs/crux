## CMakeLists.txt
```
# SPDX-License-Identifier: Apache-2.0
# RT1060-EVK Rev B management image on the Mbed TLS profile (docs/rt1060-mbed-management-image.md): HTTPS web
# management, Access with the credential store, the TLS certificate model, security events to Logging, status,
# configuration, network settings, file and reboot services. It is meant to RUN on the board and is built here,
# never flashed or reset by anything in this repository. No Wolf, no SSH.
#
# The services come from the Zephyr module under their Kconfig symbols (ADR-0004 phase 0): this file compiles
# none of their sources into `app`. What `app` holds is its own composition and the route sources, which the module
# cannot build because the route table belongs to the image.
cmake_minimum_required(VERSION 3.20.0)
get_filename_component(CRUX_ROOT "${CMAKE_CURRENT_LIST_DIR}/../../../../.." ABSOLUTE)
set(composition_dir "${CRUX_ROOT}/tests/native/management_composition")
set(EXTRA_CONF_FILE
    "${CRUX_ROOT}/tests/native/tls_offload_probe/mbed.conf"
    "${composition_dir}/profile-psa.conf")
set(DTC_OVERLAY_FILE
    "${CRUX_ROOT}/samples/boards/nxp/mimxrt1060_evk/common/network.overlay"
    "${CMAKE_CURRENT_LIST_DIR}/target.overlay"
    "${CMAKE_CURRENT_LIST_DIR}/ram_disk.overlay")
list(APPEND ZEPHYR_EXTRA_MODULES "${CRUX_ROOT}")
find_package(Zephyr REQUIRED HINTS $ENV{ZEPHYR_BASE})
project(crux_management_rt1060_mbed LANGUAGES C)

# An unsatisfied Kconfig dependency only warns, so each rule is also checked here.
if(NOT "${CONFIG_BOARD_TARGET}" STREQUAL "mimxrt1060_evk@B/mimxrt1062/qspi")
    message(FATAL_ERROR "This image is for mimxrt1060_evk@B//qspi only, not '${CONFIG_BOARD_TARGET}'")
endif()
if(NOT CONFIG_PSA_CRYPTO_PROVIDER_MBEDTLS OR NOT CONFIG_MBEDTLS)
    message(FATAL_ERROR "This image is the Mbed TLS profile: the PSA provider must be Mbed TLS")
endif()
if(NOT CONFIG_CRUX_PSA_THREADING)
    message(FATAL_ERROR "This image needs the locks of the Mbed profile's core: CONFIG_CRUX_PSA_THREADING=y")
endif()
# Entropy: the i.MX RT TRNG through its driver, and nothing else. A test generator or a fake source would make keys
# that mean nothing, so each is refused, and a missing TRNG driver is too.
if(CONFIG_TEST_RANDOM_GENERATOR OR CONFIG_FAKE_ENTROPY_NATIVE_SIM)
    message(FATAL_ERROR "This image must not use test entropy (CONFIG_TEST_RANDOM_GENERATOR, fake entropy)")
endif()
if(NOT CONFIG_ENTROPY_MCUX_TRNG OR NOT CONFIG_MBEDTLS_PSA_DRIVER_GET_ENTROPY)
    message(FATAL_ERROR "This image needs the i.MX RT TRNG driver (CONFIG_ENTROPY_MCUX_TRNG) as the PSA entropy "
                        "source (CONFIG_MBEDTLS_PSA_DRIVER_GET_ENTROPY)")
endif()
if(CONFIG_DISK_DRIVER_SDMMC OR CONFIG_IMX_USDHC)
    message(FATAL_ERROR "This image reaches no card: its file backend is a RAM disk, and the SD driver must be off")
endif()
if(NOT CONFIG_CRUX_FILE_FATFS_RAM_DISK OR NOT CONFIG_CRUX_ACCESS OR NOT CONFIG_CRUX_WEB_SESSION OR
   NOT CONFIG_CRUX_WEB_MANAGEMENT OR NOT CONFIG_CRUX_TLS_CERTIFICATE OR NOT CONFIG_CRUX_REBOOT OR
   NOT CONFIG_CRUX_FILE_SERVICE OR NOT CONFIG_CRUX_NETWORK_SETTINGS OR NOT CONFIG_CRUX_CONFIG_SERVICE OR
   NOT CONFIG_CRUX_MGMT_STATUS OR NOT CONFIG_CRUX_WEB)
    message(FATAL_ERROR "A service symbol or the RAM disk provider was dropped by Kconfig: check the configuration")
endif()
if(CONFIG_WOLFSSL OR CONFIG_CRUX_SSH OR CONFIG_CRUX_WEB_PLAIN_HTTP_FOR_TESTS)
    message(FATAL_ERROR "This image is HTTPS on Mbed TLS: no Wolf stack, no SSH, no plain HTTP")
endif()

# The random read of a failed TRNG must fail PSA and not fall back to a general-purpose generator: Zephyr's glue
# for TF-PSA-Crypto answers a failed read with sys_rand_get(), which is not cryptographic on this board.
include("${CRUX_ROOT}/cmake/CruxMbedtlsEntropy.cmake")
crux_mbedtls_fail_closed_entropy()

include("${CRUX_ROOT}/components/web/session/sources.cmake")
include("${CRUX_ROOT}/components/web/management/sources.cmake")
include("${CRUX_ROOT}/cmake/CruxWebAssets.cmake")
include("${CRUX_ROOT}/cmake/CruxWebRoutes.cmake")

# The boot check of the random source comes from test code of this repository, because no public form exists yet
# (docs/rt1060-mbed-management-image.md, "Taken from tests"). The locks of the Mbed profile's core are the module's
# own provider, CONFIG_CRUX_PSA_THREADING in prj.conf.
set(entropy_boot "${CRUX_ROOT}/tests/zephyr/entropy_boot")
target_sources(app PRIVATE src/main.c src/composition.c src/medium.c "${entropy_boot}/entropy_boot.c")
target_include_directories(app PRIVATE src "${entropy_boot}")

set(route_sources ${CRUX_WEB_SESSION_ROUTES} ${CRUX_WEB_MANAGEMENT_ROUTES}
    ${CRUX_WEB_MANAGEMENT_NETWORK_ROUTES} ${CRUX_WEB_MANAGEMENT_REBOOT_ROUTES})
target_sources(app PRIVATE ${route_sources})
# The web lifecycle has no public header on main yet (ADR-0004 phase 1a PRs 4 and 5), so its two private
# directories are the only private roots this image names (the web adapter's comes with crux_web_adapter).
target_include_directories(app PRIVATE "${CRUX_WEB_SESSION_DIR}" "${CRUX_WEB_MANAGEMENT_DIR}")
# The public usage targets carry each service's include root: `app` names no component directory for them.
target_link_libraries(app PRIVATE crux::access crux::credential_store crux::security_event crux::configuration
    crux::config_service crux::mgmt_status crux::network_settings crux::tls_certificate crux::file_service
    crux::reboot crux::web crux::file_zephyr crux::system crux::time crux_web_adapter
    crux_service_priority_placement)
target_compile_options(app PRIVATE -Wall -Wextra -Werror)
crux_web_assets(app FOLDER "${CMAKE_CURRENT_LIST_DIR}/site" STYLE strict)
crux_web_routes(app SOURCES ${route_sources} ZEPHYR_RESOURCES REVIEWED "${CMAKE_CURRENT_LIST_DIR}/reviewed-routes.txt")

# The test form of the first account (off by default, and then absent from the image altogether).
if(CONFIG_CRUX_MBED_MGMT_TEST_FIRST_ACCOUNT)
    include("${CMAKE_CURRENT_LIST_DIR}/first_account_password.cmake")
    crux_mbed_mgmt_embed_password()
    target_sources(app PRIVATE src/first_account_test.c)
    target_include_directories(app PRIVATE "${CRUX_ROOT}/components/access/adapter")
endif()
```

## Kconfig
```
# SPDX-License-Identifier: Apache-2.0
# Settings of the RT1060-EVK Rev B management image on the Mbed TLS profile (docs/rt1060-mbed-management-image.md).
mainmenu "Crux management image, RT1060-EVK Rev B, Mbed TLS profile"

config CRUX_MBED_MGMT_IPV4_ADDRESS
	string "Static IPv4 address of the board"
	default "192.168.77.2"
	help
	  The one address of the Ethernet interface. The image has no DHCP and no IPv6. The default is the dedicated
	  bench link of docs/networking-physical-preparation.md: the board is 192.168.77.2 and the host 192.168.77.1.
	  The text is also the address that the generated certificate names.

config CRUX_MBED_MGMT_IPV4_NETMASK
	string "Netmask of the static address"
	default "255.255.255.0"

config CRUX_MBED_MGMT_TEST_FIRST_ACCOUNT
	bool "TEST ONLY: first account from a password file embedded in the image"
	default n
	help
	  Off by default, and it must stay off in anything but a bench build. The image has no serial setup step (the
	  serial console is composed in no image), so without this form the image starts with no account and nobody can
	  log in. With it, the build reads a password from the file that the environment variable
	  CRUX_MBED_MGMT_PASSWORD_FILE names (outside every git work tree, 16 to 128 printable characters, no trailing
	  newline), embeds the bytes in the image as plaintext in read-only data, and creates the account `admin`
	  with the role `administrator` at every boot, because the RAM disk keeps nothing. A product does not do this:
	  it creates its first account in a serial setup step that this repository does not yet compose.

source "Kconfig.zephyr"
```

## prj.conf
```kconfig
# RT1060-EVK Rev B management image, Mbed TLS profile (docs/rt1060-mbed-management-image.md). The Mbed profile and the
# PSA settings come from the two files that CMakeLists.txt names in EXTRA_CONF_FILE (tests/native/tls_offload_probe/
# mbed.conf and management_composition/profile-psa.conf). This file holds the rest, including the locks. Every size is
# a first, unmeasured choice, and the document says which.
CONFIG_STD_C17=y
# As the native images of the services set it: the Zephyr kernel heap, which the HTTP server and the file system use.
CONFIG_HEAP_MEM_POOL_SIZE=32768
CONFIG_CRUX_MODULE=y
# The locks of the Mbed profile's core, from the module (Experimental).
CONFIG_CRUX_PSA_THREADING=y
# The main thread derives the first account's password (PBKDF2) on its stack when the test form is on.
CONFIG_MAIN_STACK_SIZE=16384
CONFIG_INIT_STACKS=y
CONFIG_THREAD_STACK_INFO=y
CONFIG_THREAD_NAME=y
CONFIG_THREAD_MONITOR=y
CONFIG_SHELL=n

# The Mbed profile beside what mbed.conf holds, as tests/zephyr/web_compile/mbedtls.conf compiles it for this board.
CONFIG_PSA_WANT_KEY_TYPE_ECC_KEY_PAIR_DERIVE=y
CONFIG_MBEDTLS_PK_WRITE_C=y

# Crux Logging, which the security events write to: the deferred UART backend on LPUART1. printk goes through it, so
# there is one writer and the console lines and the events are in order.
CONFIG_PRINTK=y
CONFIG_CRUX_LOGGING=y
CONFIG_SERIAL=y
CONFIG_LOG=y
CONFIG_LOG_MODE_DEFERRED=y
CONFIG_LOG_MODE_OVERFLOW=n
CONFIG_LOG_BLOCK_IN_THREAD=n
CONFIG_LOG_PROCESS_THREAD=y
CONFIG_LOG_PROCESS_THREAD_STACK_SIZE=2048
CONFIG_LOG_PROCESS_THREAD_CUSTOM_PRIORITY=y
CONFIG_LOG_PROCESS_THREAD_PRIORITY=14
CONFIG_LOG_BUFFER_SIZE=4096
CONFIG_LOG_MAX_LEVEL=4
CONFIG_LOG_DEFAULT_LEVEL=0
CONFIG_LOG_RUNTIME_FILTERING=n
CONFIG_LOG_BACKEND_UART=y
CONFIG_LOG_BACKEND_UART_ASYNC=n
CONFIG_LOG_BACKEND_SHOW_LEVEL=y
CONFIG_UART_CONSOLE=y
CONFIG_LOG_PRINTK=y
CONFIG_STDOUT_CONSOLE=n
CONFIG_CONSOLE_HANDLER=n
CONFIG_CONSOLE_SUBSYS=n
CONFIG_EARLY_CONSOLE=n
CONFIG_BOOT_BANNER=n

# Ethernet and the TLS socket layer on the target's own network stack. The address is static (main.c).
CONFIG_NETWORKING=y
CONFIG_NET_L2_ETHERNET=y
CONFIG_NET_IPV4=y
CONFIG_NET_IPV6=n
CONFIG_NET_TCP=y
CONFIG_NET_TCP_ISN_RFC6528=y
CONFIG_NET_UDP=y
CONFIG_NET_SOCKETS=y
CONFIG_NET_DHCPV4=n
CONFIG_NET_CONFIG_SETTINGS=n
CONFIG_NET_MAX_CONTEXTS=32
CONFIG_NET_MAX_CONN=32
CONFIG_PHY_MONITOR_PERIOD=500
CONFIG_NET_SOCKETS_SOCKOPT_TLS=y
CONFIG_TLS_CREDENTIALS=y
CONFIG_TLS_MAX_CREDENTIALS_NUMBER=4
CONFIG_NET_SOCKETS_TLS_MAX_CONTEXTS=6
CONFIG_ZVFS_OPEN_MAX=48
CONFIG_ZVFS_POLL_MAX=24
CONFIG_ZVFS_EVENTFD=y

# Network buffers, as the RT1060-EVKB bench image sizes them for its declared sessions (docs/rt1060-bench-network-buffers.md,
# paper rules, not measured on a board). This image serves HTTPS only, which is the smaller load, so these are the
# bench's numbers taken whole and not a new sizing.
CONFIG_NET_BUF_DATA_SIZE=128
CONFIG_NET_TCP_MAX_RECV_WINDOW_SIZE=5840
CONFIG_NET_TCP_MAX_SEND_WINDOW_SIZE=5840
CONFIG_NET_BUF_RX_COUNT=1024
CONFIG_NET_BUF_TX_COUNT=768
CONFIG_NET_PKT_RX_COUNT=192
CONFIG_NET_PKT_TX_COUNT=32
CONFIG_ETH_NXP_ENET_RX_BUFFERS=6
CONFIG_HTTP_SERVER_MAX_CLIENTS=3
CONFIG_CRUX_WEB_BACKLOG=4

# Entropy: the i.MX RT TRNG through its driver. No test generator, no fake entropy: CMakeLists.txt refuses both.
CONFIG_ENTROPY_GENERATOR=y
CONFIG_HWINFO=y

# Web adapter, HTTPS only. The server thread runs each TLS handshake inside accept, and the stack of an Mbed TLS handshake
# on this board is not measured: 16,384 B is a generous first choice, and a board run reads the real figure.
CONFIG_CRUX_WEB=y
CONFIG_CRUX_WEB_PORT=443
CONFIG_HTTP_SERVER_STACK_SIZE=16384

# The management services, from the Zephyr module under their own symbols. They select the Crux Thread, Sync and Time
# symbols themselves (ADR-0004 C6), so none is named here.
CONFIG_CRUX_ACCESS=y
CONFIG_CRUX_CONFIG_SERVICE=y
CONFIG_CRUX_MGMT_STATUS=y
CONFIG_CRUX_NETWORK_SETTINGS=y
# The apply port that applies nothing: a PUT to /api/v1/network answers 501, and nothing is applied to the interface.
CONFIG_CRUX_NETWORK_SETTINGS_NO_APPLY=y
CONFIG_CRUX_TLS_CERTIFICATE=y
CONFIG_CRUX_FILE_SERVICE=y
CONFIG_CRUX_REBOOT=y
CONFIG_CRUX_WEB_SESSION=y
CONFIG_CRUX_WEB_MANAGEMENT=y

# Crux capabilities that the services read and the reset path uses.
CONFIG_CRUX_NETIF=y
CONFIG_CRUX_SYSTEM=y
CONFIG_WATCHDOG=y
CONFIG_REBOOT=y

# The file backend: the File service on FatFs over a RAM disk of 512 KiB in SDRAM (ram_disk.overlay), with no card driver
# in the image. Nothing persists across a reset: accounts, keys, the certificate and the events are made again at each
# boot. src/medium.c formats the RAM disk when it mounts blank, and never anything else.
CONFIG_FILE_SYSTEM=y
CONFIG_FILE_SYSTEM_MKFS=y
CONFIG_FAT_FILESYSTEM_ELM=y
CONFIG_FS_FATFS_LFN=y
CONFIG_FS_FATFS_LFN_MODE_STACK=y
CONFIG_FS_FATFS_MAX_LFN=127
CONFIG_FS_FATFS_MOUNT_MKFS=n
CONFIG_FS_FATFS_REENTRANT=y
CONFIG_FS_FATFS_NUM_FILES=6
CONFIG_DISK_DRIVERS=y
CONFIG_DISK_DRIVER_RAM=y
CONFIG_CRUX_FILE_FATFS_RAM_DISK=y
# Zephyr turns the SD card driver and the USDHC host on when the board's devicetree has the card's node (it has), so
# this image turns them off: with them off it has no card to mount or format.
CONFIG_DISK_DRIVER_SDMMC=n
CONFIG_IMX_USDHC=n
```

## src/main.c
```c
/* SPDX-License-Identifier: Apache-2.0 */
/*
 * RT1060-EVK Rev B management image on the Mbed TLS profile (docs/rt1060-mbed-management-image.md):
 * HTTPS web management with Access, the credential store and the TLS certificate model, security
 * events to Logging on the console UART. Built here and meant to run on the board: nothing in this
 * repository flashes or resets one.
 *
 * Boot order, and what stops the image: every refusal ends in an MBED-MGMT refusing-to-start line
 * (a failed step prints its own detail line first), and nothing after it runs.
 *   1. The first random read, before anything makes a key. A failed TRNG read stops the image: no
 * key, certificate or listener is made. There is no fallback source and no test entropy.
 *   2. The static address.
 *   3. The core services: events, time, RAM disk, credential store, Access, configuration, status.
 *   4. The first account, only on an empty store, and only with the test form, which is off by
 * default.
 *   5. The services that need a key and an account store, and then the HTTPS listener.
 */
#include "composition.h"

#include "entropy_boot.h"

#include <zephyr/kernel.h>
#include <zephyr/sys/printk.h>

static int image_main(void)
{
    printk("MBED-MGMT evaluation image, not a product: image=crux-mgmt-rt1060-mbed board=%s "
           "tls=mbedtls address=%s test-first-account=%d\n",
           CONFIG_BOARD_TARGET, CONFIG_CRUX_MBED_MGMT_IPV4_ADDRESS,
           IS_ENABLED(CONFIG_CRUX_MBED_MGMT_TEST_FIRST_ACCOUNT));
    /* The first random read, through the same function that makes every key, and one CRUX-ENTROPY
     * line that says which device answered. tests/zephyr/entropy_boot,
     * docs/psa-crypto-qualification.md (Entropy failure). */
    if (!crux_entropy_boot_check()) {
        printk(
            "MBED-MGMT refusing to start: the first random read failed, no key or listener made\n");
        return 1;
    }
    if (!composition_address_up()) {
        printk("MBED-MGMT refusing to start: the static address could not be set\n");
        return 1;
    }
    if (!composition_core_start()) {
        printk("MBED-MGMT refusing to start: a core service did not start\n");
        return 1;
    }
    if (composition_store_state_at_start() == CRUX_CREDENTIAL_STATE_EMPTY) {
#if defined(CONFIG_CRUX_MBED_MGMT_TEST_FIRST_ACCOUNT)
        if (!composition_first_account_test()) {
            printk("MBED-MGMT refusing to start: the first account could not be made\n");
            return 1;
        }
#else
        printk("MBED-MGMT no first account: this image has no serial setup step, so nobody can log "
               "in. "
               "Build with CONFIG_CRUX_MBED_MGMT_TEST_FIRST_ACCOUNT for a bench account\n");
#endif
    }
    if (!composition_services_start()) {
        printk("MBED-MGMT refusing to start: a service did not start\n");
        return 1;
    }
    printk("MBED-MGMT ready https://%s:%d/\n", CONFIG_CRUX_MBED_MGMT_IPV4_ADDRESS,
           CONFIG_CRUX_WEB_PORT);
    return 0;
}

int main(void)
{
    return image_main();
}
```

## src/composition.c
```c
/* SPDX-License-Identifier: Apache-2.0 */
/* The management services of this image: the order of docs/management-in-a-product.md, the policy,
 * and one reference parameter. The services themselves come from the Zephyr module under their
 * Kconfig symbols. The web lifecycle headers are the private ones until ADR-0004 phase 1a publishes
 * them (see the transitional list in tests/build/test_management_mbed_rt1060_image.py). */
#include "composition.h"

#include "medium.h"

#include "crux_web_adapter.h"
#include "crux_web_management.h"
#include "crux_web_session.h"

#include <crux/access.h>
#include <crux/config_service.h>
#include <crux/configuration.h>
#include <crux/credential_store.h>
#include <crux/file_service.h>
#include <crux/file_zephyr.h>
#include <crux/management_status.h>
#include <crux/network_settings.h>
#include <crux/reboot.h>
#include <crux/security_event.h>
#include <crux/system.h>
#include <crux/time.h>
#include <crux/tls_certificate_start.h>

#include <errno.h>
#include <string.h>
#include <zephyr/fs/fs.h>
#include <zephyr/net/net_if.h>
#include <zephyr/net/tls_credentials.h>
#include <zephyr/sys/printk.h>
#include <zephyr/sys/util.h>

enum { ROOT_SLOT_A = 1, ROOT_SLOT_B = 2, ROOT_FILES = 3 };
#define PATH_SLOT_A MEDIUM_MOUNT_POINT "/secure-a"
#define PATH_SLOT_B MEDIUM_MOUNT_POINT "/secure-b"
#define PATH_FILES MEDIUM_MOUNT_POINT "/files"
#define FILE_AREA "files"
#define PERMISSION_FILE_READ "file.read"
#define PERMISSION_FILE_WRITE "file.write"
#define PERMISSION_CONFIG_READ "config.read"
#define PERMISSION_CONFIG_WRITE "config.write"
#define PARAM_NAME "device.name"

static const char *const viewer_permissions[] = {
    CRUX_MGMT_STATUS_PERMISSION_READ, PERMISSION_CONFIG_READ, CRUX_NETWORK_SETTINGS_PERMISSION_READ,
    PERMISSION_FILE_READ};
static const char *const operator_permissions[] = {
    CRUX_MGMT_STATUS_PERMISSION_READ,      PERMISSION_CONFIG_READ, PERMISSION_CONFIG_WRITE,
    CRUX_NETWORK_SETTINGS_PERMISSION_READ, PERMISSION_FILE_READ,   PERMISSION_FILE_WRITE};
static const char *const administrator_permissions[] = {
    CRUX_MGMT_STATUS_PERMISSION_READ,
    PERMISSION_CONFIG_READ,
    PERMISSION_CONFIG_WRITE,
    CRUX_CONFIG_SERVICE_PERMISSION_SAVE,
    CRUX_SECURITY_EVENT_PERMISSION_READ,
    CRUX_ACCESS_PERMISSION_MANAGE,
    CRUX_NETWORK_SETTINGS_PERMISSION_READ,
    CRUX_NETWORK_SETTINGS_PERMISSION_WRITE,
    CRUX_REBOOT_PERMISSION,
    PERMISSION_FILE_READ,
    PERMISSION_FILE_WRITE,
};
static const crux_access_role_t roles[] = {
    {"viewer", viewer_permissions, ARRAY_SIZE(viewer_permissions)},
    {"operator", operator_permissions, ARRAY_SIZE(operator_permissions)},
    {"administrator", administrator_permissions, ARRAY_SIZE(administrator_permissions)},
};
static const crux_access_policy_t policy = {roles, ARRAY_SIZE(roles), 15u * 60u, 8u * 3600u, NULL};

/* One reference parameter, so that the configuration routes have something to list. A product names
 * its own. */
static const crux_config_spec_t spec_name = {
    .key = PARAM_NAME,
    .default_value = {.type = CRUX_CONFIG_STRING, .data.string = {"crux-rt1060", 11}},
};
static crux_config_param_t param_name;
static char storage_name[64];
static const crux_config_service_entry_t table[] = {
    {&param_name, PERMISSION_CONFIG_READ, PERMISSION_CONFIG_WRITE, false,
     CRUX_CONFIG_ACTIVATION_APPLICATION},
};
/* The reference table and then the entries of the network settings service, in the order that it
 * hands them over. */
static crux_config_service_entry_t
    services_table[ARRAY_SIZE(table) + CRUX_NETWORK_SETTINGS_ENTRY_COUNT];

static crux_credential_state_t state_at_start = CRUX_CREDENTIAL_STATE_UNUSABLE;
static bool certificate_generated;

/* The address of the interface, parsed once. */
static struct net_in_addr address;
static struct net_in_addr netmask;

static bool address_parse(void)
{
    return net_addr_pton(NET_AF_INET, CONFIG_CRUX_MBED_MGMT_IPV4_ADDRESS, &address) == 0 &&
           net_addr_pton(NET_AF_INET, CONFIG_CRUX_MBED_MGMT_IPV4_NETMASK, &netmask) == 0;
}

static bool failed(const char *step)
{
    printk("MBED-MGMT step failed: %s\n", step);
    return false;
}

bool composition_address_up(void)
{
    struct net_if *iface = net_if_get_default();
    struct net_if_ipv4 *ipv4;
    size_t used = 0;

    if (iface == NULL || !address_parse() ||
        net_if_ipv4_addr_add(iface, &address, NET_ADDR_MANUAL, 0) == NULL ||
        !net_if_ipv4_set_netmask_by_addr(iface, &address, &netmask)) {
        return failed("address");
    }
    int status = net_if_up(iface);
    if (status != 0 && status != -EALREADY) {
        return failed("interface up");
    }
    /* The interface has this address and no other IPv4 address, so that the listener answers on
     * this one. */
    if (net_if_config_ipv4_get(iface, &ipv4) != 0 || ipv4 == NULL) {
        return failed("address check");
    }
    for (size_t i = 0; i < NET_IF_MAX_IPV4_ADDR; i++) {
        if (!ipv4->unicast[i].ipv4.is_used) {
            continue;
        }
        used++;
        if (!net_ipv4_addr_cmp(&ipv4->unicast[i].ipv4.address.in_addr, &address)) {
            return failed("another IPv4 address on the interface");
        }
    }
    return used == 1u || failed("address count");
}

static bool directory_ready(const char *path)
{
    int result = fs_mkdir(path);
    return result == 0 || result == -EEXIST;
}

static bool medium_ready(void)
{
    if (!medium_mount()) {
        return false;
    }
    return directory_ready(PATH_SLOT_A) && directory_ready(PATH_SLOT_B) &&
           directory_ready(PATH_FILES) &&
           crux_file_zephyr_bind_root(ROOT_SLOT_A, PATH_SLOT_A) == CRUX_FILE_OK &&
           crux_file_zephyr_bind_root(ROOT_SLOT_B, PATH_SLOT_B) == CRUX_FILE_OK &&
           crux_file_zephyr_bind_root(ROOT_FILES, PATH_FILES) == CRUX_FILE_OK;
}

/* Network settings boot before the Configuration service starts, on a table that holds its entries.
 * The default is the interface's own static address. Nothing is applied to the interface: the apply
 * port applies nothing. */
static bool config_ready(void)
{
    size_t count = 0;
    uint8_t prefix = 0;
    uint32_t host_address = ((uint32_t)address.s4_addr[0] << 24) |
                            ((uint32_t)address.s4_addr[1] << 16) |
                            ((uint32_t)address.s4_addr[2] << 8) | (uint32_t)address.s4_addr[3];

    for (size_t i = 0; i < 4; i++) {
        prefix += (uint8_t)__builtin_popcount(netmask.s4_addr[i]);
    }
    const crux_network_settings_config_t network = {
        .defaults = {.address = host_address, .prefix_length = prefix, .has_gateway = false}};
    const crux_config_service_entry_t *entries = crux_network_settings_entries(&count);

    if (crux_config_init_string(&param_name, &spec_name, storage_name, sizeof(storage_name)) !=
            CRUX_CONFIG_OK ||
        entries == NULL || count != CRUX_NETWORK_SETTINGS_ENTRY_COUNT) {
        return false;
    }
    memcpy(services_table, table, sizeof(table));
    memcpy(&services_table[ARRAY_SIZE(table)], entries, sizeof(services_table[0]) * count);
    return crux_network_settings_boot(&network, NULL) == CRUX_NETWORK_OK &&
           crux_config_service_start(services_table, ARRAY_SIZE(services_table)) ==
               CRUX_CONFIG_SERVICE_OK;
}

bool composition_core_start(void)
{
    /* First, so that everything that follows can emit. */
    if (crux_security_event_init(NULL, 0) != CRUX_OK) {
        return failed("security events");
    }
    if (crux_realtime_init() != CRUX_OK) {
        return failed("time");
    }
    /* A medium that failed fails closed inside the store: it starts, and reads UNUSABLE. */
    if (!medium_ready()) {
        printk("MBED-MGMT medium not ready: the credential store will be unusable\n");
    }
    crux_credential_result_t store = crux_credential_start(ROOT_SLOT_A, ROOT_SLOT_B);
    if (store != CRUX_CREDENTIAL_OK && store != CRUX_CREDENTIAL_ERR_UNUSABLE) {
        return failed("credential store");
    }
    /* A failed read leaves the state UNUSABLE: it fails closed and no first account is created. */
    crux_credential_store_info_t info;
    state_at_start = CRUX_CREDENTIAL_STATE_UNUSABLE;
    if (crux_credential_store_get_info(&info) == CRUX_OK) {
        state_at_start = info.state;
    }
    /* An unusable store reads NOT_READY here and stays so: it fails closed. */
    crux_access_result_t access = crux_access_init(&policy);
    if (access != CRUX_ACCESS_OK && access != CRUX_ACCESS_ERR_NOT_READY) {
        return failed("access");
    }
    if (!address_parse() || !config_ready()) {
        return failed("configuration");
    }
    crux_reset_cause_t cause = {0};
    crux_mgmt_status_config_t status = {
        .platform_version = "crux",
        .project_version = "rt1060-mbed",
        .boot_reset_cause_status = crux_system_reset_cause_get(&cause),
        .boot_reset_cause = cause,
    };
    if (crux_mgmt_status_start(&status) != CRUX_OK) {
        return failed("status");
    }
    if (crux_security_event_start() != CRUX_OK) {
        return failed("security event thread");
    }
    return true;
}

crux_credential_state_t composition_store_state_at_start(void)
{
    return state_at_start;
}

/* The generated certificate to Zephyr's TLS credentials, as docs/tls-certificate.md step 6 says,
 * before the listener. */
static int tls_credentials_register(int sec_tag)
{
    static crux_tls_certificate_material_t material;

    if (crux_tls_certificate_material_take(&material) != CRUX_TLS_CERTIFICATE_OK) {
        return -ENOENT;
    }
    int result = tls_credential_add(sec_tag, TLS_CREDENTIAL_PUBLIC_CERTIFICATE,
                                    material.certificate, material.certificate_length);
    if (result == 0) {
        result = tls_credential_add(sec_tag, TLS_CREDENTIAL_PRIVATE_KEY, material.private_key,
                                    material.private_key_length);
    }
    return result;
}

static const crux_file_area_t areas[] = {{
    .name = FILE_AREA,
    .root = ROOT_FILES,
    .read_permission = PERMISSION_FILE_READ,
    .write_permission = PERMISSION_FILE_WRITE,
    .max_file_bytes = 4096u,
    .max_area_bytes = 16384u,
    .max_entries = 8u,
    .partial_suffix = NULL,
    .write_modes = CRUX_FILE_SERVICE_MANAGED,
}};
static crux_file_root_t reserved_roots[] = {ROOT_SLOT_A, ROOT_SLOT_B};

bool composition_services_start(void)
{
    /* The certificate names the DNS name and the address of the board. The module reads no clock.
     */
    static const char *const dns_names[] = {"crux-rt1060"};
    static uint8_t ipv4_names[1][4];
    static crux_tls_certificate_options_t certificate_options;
    crux_tls_certificate_start_t how = CRUX_TLS_CERTIFICATE_STARTED;

    memcpy(ipv4_names[0], address.s4_addr, 4);
    certificate_options = (crux_tls_certificate_options_t){
        .names = {.common_name = "crux rt1060 management",
                  .dns_names = dns_names,
                  .dns_count = ARRAY_SIZE(dns_names),
                  .ipv4 = (const uint8_t(*)[4])ipv4_names,
                  .ipv4_count = ARRAY_SIZE(ipv4_names)},
        .not_before_s = CRUX_TLS_CERTIFICATE_DEFAULT_NOT_BEFORE_S,
        .validity_days = 0u,
    };
    /* The device key is made inside this call, from the TRNG. */
    if (crux_tls_certificate_start(&certificate_options, &how) != CRUX_TLS_CERTIFICATE_OK) {
        return failed("tls certificate");
    }
    certificate_generated = how == CRUX_TLS_CERTIFICATE_GENERATED;
    if (crux_network_settings_start() != CRUX_NETWORK_OK ||
        crux_network_settings_start_worker() != CRUX_NETWORK_OK) {
        return failed("network settings");
    }
    /* Borrowed by the service for the program's life: static. */
    static const crux_file_service_config_t file_config = {
        .areas = areas,
        .area_count = ARRAY_SIZE(areas),
        .reserved_roots = reserved_roots,
        .reserved_root_count = ARRAY_SIZE(reserved_roots),
        .no_credential_store = false,
    };
    if (crux_file_service_start(&file_config) != CRUX_FILE_SERVICE_OK) {
        return failed("file service");
    }
    /* The restart is the application's judgement. This image states that it never refuses, and it
     * runs no machine. */
    static const crux_reboot_config_t reboot = {.policy_kind = CRUX_REBOOT_POLICY_ALWAYS_ALLOW};
    if (crux_reboot_start(&reboot) != CRUX_REBOOT_OK ||
        crux_reboot_start_worker() != CRUX_REBOOT_OK) {
        return failed("reboot");
    }
    /* HTTPS only: the session module refuses "http" in a build like this one. */
    static const crux_web_session_config_t sessions = {"https", NULL, 0u};
    if (crux_web_session_init(&sessions) != CRUX_WEB_OK ||
        crux_web_session_start_worker() != CRUX_WEB_OK) {
        return failed("web session");
    }
    if (crux_web_management_init() != CRUX_WEB_OK ||
        crux_web_management_start_worker() != CRUX_WEB_OK) {
        return failed("web management");
    }
    if (tls_credentials_register(CONFIG_CRUX_WEB_TLS_SEC_TAG) != 0) {
        return failed("tls credentials");
    }
    /* Trust on first use: the user compares this with what the client shows. It is read before the
     * listener starts, so a certificate that cannot be read never has a listener. */
    char fingerprint[CRUX_TLS_CERTIFICATE_FINGERPRINT_TEXT_SIZE];
    if (crux_tls_certificate_fingerprint(fingerprint) != CRUX_TLS_CERTIFICATE_OK) {
        return failed("certificate fingerprint");
    }
    printk("MBED-MGMT certificate sha256=%s source=%s\n", fingerprint,
           certificate_generated ? "generated" : "stored");
    static const crux_web_config_t web = {
        .authenticate = crux_web_session_authenticate,
        .request_deadline_ms = CONFIG_CRUX_WEB_REQUEST_DEADLINE_MS,
        .handler_limit_ms = 100u,
    };
    if (crux_web_start(&web) != CRUX_WEB_OK) {
        return failed("https listener");
    }
    return true;
}
```
