## samples/boards/nxp/mimxrt1060_evk/sd_card_file/sample.yaml
```yaml
sample:
  name: Crux microSD composition (link only)
common:
  build_only: true
  platform_allow: [mimxrt1060_evk@B/mimxrt1062/qspi]
  tags: [filesystem, crux, link_only]
tests:
  crux.sample.boards.mimxrt1060_evk.sd_card_file:
    extra_args: []
  crux.sample.boards.mimxrt1060_evk.sd_card_file.start:
    extra_configs:
      - CONFIG_SAMPLE_SD_START=y
```

## samples/controller/zephyr/sample.yaml
```yaml
sample:
  name: Crux reference controller
  description: >-
    The basic periodic controller scenario: 20 cycles of Time observation on a 100 ms grid,
    then a completion line. The other configurations in this folder are board probes and
    are not part of this sample entry.
common:
  tags: [crux, sample, controller]
  platform_allow:
    - native_sim/native/64
    - mimxrt1060_evk@B/mimxrt1062/qspi
  integration_platforms:
    - native_sim/native/64
  harness: console
  harness_config:
    type: multi_line
    ordered: true
    regex:
      - "controller composition=zephyr init=0"
      - "CONTROLLER_COMPLETE cycles=20"
tests:
  crux.sample.controller.basic:
    extra_args: []
```

## samples/file/write_read/sample.yaml
```yaml
sample:
  name: Crux File write and read
  description: >-
    Writes a file through the Crux File API and reads it back. The two scenarios build the
    same application source and differ only in the Kconfig fragment and devicetree overlay
    that select the File provider. Both providers are Experimental.
common:
  tags: [crux, sample, file]
  platform_allow:
    - native_sim/native/64
  integration_platforms:
    - native_sim/native/64
  harness: console
tests:
  crux.sample.file.write_read.simulator:
    harness_config:
      type: multi_line
      ordered: true
      regex:
        - "Storage: LittleFS on the flash simulator, bound at /lfs/files"
        - "Wrote 25 bytes to greeting.txt"
        - "Read 25 bytes: Hello from Crux File API!"
        - "CRUX_FILE_WRITE_READ_OK provider=simulator"
  crux.sample.file.write_read.fatfs_ram_disk:
    extra_args:
      - EXTRA_CONF_FILE=fatfs_ram_disk.conf
      - EXTRA_DTC_OVERLAY_FILE=fatfs_ram_disk.overlay
    harness_config:
      type: multi_line
      ordered: true
      regex:
        - "Storage: FatFs on a RAM disk, bound at /RAM:/files"
        - "Wrote 25 bytes to greeting.txt"
        - "Read 25 bytes: Hello from Crux File API!"
        - "CRUX_FILE_WRITE_READ_OK provider=fatfs_ram_disk"
```

## samples/management_rt1060_mbed/testcase.yaml
```yaml
sample:
  name: Crux management image on RT1060-EVK Rev B, Mbed TLS profile (cross-build only)
common:
  build_only: true
  platform_allow: [mimxrt1060_evk@B/mimxrt1062/qspi]
  tags: [crux, management, mbedtls, link_only]
tests:
  crux.sample.management_rt1060_mbed:
    extra_args: []
```

## samples/networking/tcp_udp_echo/sample.yaml
```yaml
sample:
  name: Crux TCP and UDP echo
  description: >-
    Brings up the EVKB Ethernet interface with a fixed IPv4 address, prints the Crux Netif status,
    and exchanges one TCP and one UDP echo with a peer at 192.168.77.1 ports 42420 and 42421.
    It runs only on a board on an isolated network with that peer (fixture crux_echo_peer);
    without the fixture Twister only builds it.
common:
  tags: [crux, networking]
  platform_allow:
    - mimxrt1060_evk@B/mimxrt1062/qspi
  integration_platforms:
    - mimxrt1060_evk@B/mimxrt1062/qspi
  harness: console
  harness_config:
    fixture: crux_echo_peer
    type: multi_line
    ordered: true
    regex:
      - "^NETIF admin=[01] link=-?[0-9]+ address=[01]$"
      - "^NETWORK tcp=0 udp=0$"
tests:
  crux.sample.networking.tcp_udp_echo:
    # The same network overlay that scripts/test-networking.sh passes; relative to this folder.
    extra_args:
      - DTC_OVERLAY_FILE="../../controller/zephyr/m3-network.overlay"
```

## samples/time/shell/zephyr/sample.yaml
```yaml
sample:
  name: Crux time shell
  description: >-
    Zephyr shell with the Crux Time commands. It prints its ready line and then waits for
    commands such as `time get`; Twister stops it after the ready line.
common:
  tags: [crux, sample, time]
  platform_allow:
    - native_sim/native/64
    - mimxrt1060_evk@B/mimxrt1062/qspi
  integration_platforms:
    - native_sim/native/64
  harness: console
  harness_config:
    type: one_line
    regex:
      - "CRUX_TIME_READY composition=zephyr"
tests:
  crux.sample.time.shell:
    extra_args: []
```

## templates/hardware-module/Kconfig
```kconfig
# SPDX-License-Identifier: Apache-2.0

menuconfig ACMECO_HW
	bool "Acme shared hardware module"
	default y
	help
	  Drivers that two or more products of the organisation share. Each
	  driver below is enabled by devicetree, not by this symbol alone.

if ACMECO_HW

rsource "drivers/Kconfig"

endif # ACMECO_HW
```

## templates/hardware-module/boards/acmeco/ctrl_a/Kconfig.acmeco_ctrl_a
```kconfig
# SPDX-License-Identifier: Apache-2.0

config BOARD_ACMECO_CTRL_A
	select SOC_PART_NUMBER_MIMXRT1062DVL6A
```

## templates/product/boards/vnd/example_rt1062/Kconfig.example_rt1062
```kconfig
# Example RT1062 board configuration

# Modelled on boards/nxp/mimxrt1060_evk/Kconfig.mimxrt1060_evk of Zephyr (Copyright (c) 2018, NXP).
# SPDX-License-Identifier: Apache-2.0

config BOARD_EXAMPLE_RT1062
	select SOC_PART_NUMBER_MIMXRT1062DVL6A
```

## templates/product/boards/vnd/example_rt1062/example_rt1062_mimxrt1062_defconfig
```kconfig
# Modelled on boards/nxp/mimxrt1060_evk/mimxrt1060_evk_mimxrt1062_qspi_defconfig of Zephyr
# (Copyright (c) 2018, NXP).
# SPDX-License-Identifier: Apache-2.0

CONFIG_CONSOLE=y
CONFIG_UART_CONSOLE=y
CONFIG_SERIAL=y
CONFIG_GPIO=y
CONFIG_ARM_MPU=y
CONFIG_HW_STACK_PROTECTION=y
```

## templates/product/drivers/sensor/example_temp/Kconfig
```kconfig
# Example temperature sensor configuration options

# Modelled on drivers/sensor/f75303/Kconfig of Zephyr (Copyright (c) 2023 Google LLC).
# SPDX-License-Identifier: Apache-2.0

config EXAMPLE_TEMP
	bool "Example temperature sensor"
	default y
	depends on DT_HAS_VND_EXAMPLE_TEMP_ENABLED
	select I2C
	help
	  Enable the driver for the example temperature sensor of this template. The part is
	  fictional: the driver shows the shape of a product driver and is not meant to be shipped.

if EXAMPLE_TEMP

config EMUL_EXAMPLE_TEMP
	bool "Emulator for the example temperature sensor"
	default y
	depends on EMUL
	help
	  Enable the emulator of the sensor, a model of the part's registers behind Zephyr's bus
	  emulator. It exists for tests on native_sim; only test configurations enable it.

module = EXAMPLE_TEMP
module-str = Example temperature sensor
source "subsys/logging/Kconfig.template.log_config"

endif # EXAMPLE_TEMP
```

## templates/product/dts/bindings/sensor/vnd,example-temp.yaml
```yaml
# SPDX-License-Identifier: Apache-2.0

description: |
  Example temperature sensor of the product template. The part is fictional.
  It is read over I2C, reports one temperature channel and has a part identifier register.

  The file name is the compatible, and the compatible is <vendor prefix>,<part>. The vendor
  prefix "vnd" stands in for a real vendor in examples and tests. A binding for the product's own
  part uses a prefix that is listed in dts/bindings/vendor-prefixes.txt.

compatible: "vnd,example-temp"

include: [sensor-device.yaml, i2c-device.yaml]
```
