## CMakeLists.txt
```
# SPDX-License-Identifier: Apache-2.0

# A link probe for the product template, not a product example. The same adapter, which calls
# kernel message queue functions, is linked in one of three ways (PROBE_VARIANT):
#   app_sources     a source of the app target
#   plain_static    a plain CMake STATIC library that app links (expected to fail to link)
#   module_library  a zephyr_library_named library of a Zephyr module (module/)
# scripts/test-product-template.sh builds each variant for native_sim and checks the outcome.
cmake_minimum_required(VERSION 3.20.0)
find_package(Zephyr REQUIRED HINTS $ENV{ZEPHYR_BASE})
project(product_template_link)

set(PROBE_VARIANT "app_sources" CACHE STRING "app_sources, plain_static or module_library")
set_property(CACHE PROBE_VARIANT PROPERTY STRINGS app_sources plain_static module_library)

target_sources(app PRIVATE src/main.c)
target_include_directories(app PRIVATE src)
target_compile_options(app PRIVATE -Wall -Wextra -Werror)

if(PROBE_VARIANT STREQUAL "app_sources")
  target_sources(app PRIVATE src/queue_adapter.c)
elseif(PROBE_VARIANT STREQUAL "plain_static")
  add_library(probe_queue_adapter STATIC src/queue_adapter.c)
  target_link_libraries(probe_queue_adapter PUBLIC zephyr_interface)
  # Zephyr orders its own libraries after the generated headers. A plain library must ask.
  add_dependencies(probe_queue_adapter zephyr_generated_headers)
  target_compile_options(probe_queue_adapter PRIVATE -Wall -Wextra -Werror)
  target_link_libraries(app PRIVATE probe_queue_adapter)
elseif(PROBE_VARIANT STREQUAL "module_library")
  # module/CMakeLists.txt builds the adapter when the module is named with ZEPHYR_EXTRA_MODULES.
  if(NOT TARGET probe_queue_module)
    message(FATAL_ERROR "module_library needs -DZEPHYR_EXTRA_MODULES=<this folder>/module")
  endif()
else()
  message(FATAL_ERROR "Unknown PROBE_VARIANT: ${PROBE_VARIANT}")
endif()
```

## prj.conf
```kconfig
# SPDX-License-Identifier: Apache-2.0
CONFIG_PRINTK=y
```

## src/main.c
```c
/* SPDX-License-Identifier: Apache-2.0 */

#include "queue_adapter.h"

#include <zephyr/sys/printk.h>

int main(void)
{
    printk("queue round trip: %d\n", queue_adapter_roundtrip(7));
    return 0;
}
```

## src/queue_adapter.c
```c
/* SPDX-License-Identifier: Apache-2.0 */

#include "queue_adapter.h"

#include <zephyr/kernel.h>

/* The four calls of the reported link failure. Nothing else in a minimal image uses them, so the
 * kernel archive member that defines them is linked only if this file's references reach it. */
static char queue_buffer[4 * sizeof(int)];
static struct k_msgq queue;

int queue_adapter_roundtrip(int value)
{
    int out = -1;

    k_msgq_init(&queue, queue_buffer, sizeof(int), 4);
    if (k_msgq_put(&queue, &value, K_NO_WAIT) != 0) {
        return -1;
    }
    if (k_msgq_get(&queue, &out, K_NO_WAIT) != 0) {
        return -1;
    }
    k_msgq_purge(&queue);
    return out;
}
```

## src/queue_adapter.h
```c
/* SPDX-License-Identifier: Apache-2.0 */

#ifndef PRODUCT_TEMPLATE_LINK_QUEUE_ADAPTER_H_
#define PRODUCT_TEMPLATE_LINK_QUEUE_ADAPTER_H_

/* Puts value through a kernel message queue and returns what comes out, or -1. */
int queue_adapter_roundtrip(int value);

#endif /* PRODUCT_TEMPLATE_LINK_QUEUE_ADAPTER_H_ */
```
