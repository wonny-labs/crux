## CMakeLists.txt
```
# SPDX-License-Identifier: Apache-2.0
# ADR-0004 T3: a product outside the Crux repository that composes the management services. Build it from a
# copy outside the repository with scripts/test-consumer-composition.sh, which passes
#   -DZEPHYR_EXTRA_MODULES=<repo> -DCRUX_DIR=<repo>
# CRUX_DIR is the directory of the crux-pilot project in the product's workspace, as docs/management-in-a-product.md
# says, and the product sets it. Nothing here names a file under components/: the product links crux:: targets
# and includes <crux/...> headers.
cmake_minimum_required(VERSION 3.20.0)
find_package(Zephyr REQUIRED HINTS $ENV{ZEPHYR_BASE})
project(consumer_composition LANGUAGES C)

if(NOT DEFINED CRUX_DIR)
    message(FATAL_ERROR "Set CRUX_DIR to the crux-pilot project of the workspace")
endif()
if(NOT CONFIG_BOARD_NATIVE_SIM OR NOT CONFIG_FAKE_ENTROPY_NATIVE_SIM)
    message(FATAL_ERROR "This product is a native_sim test image: its entropy is test-only")
endif()

include(${CRUX_DIR}/cmake/CruxWebAssets.cmake)
include(${CRUX_DIR}/cmake/CruxWebRoutes.cmake)

# The Mbed profile's locks for TF-PSA-Crypto's core: product glue, in this project (see tf_psa_threading/).
target_sources(app PRIVATE src/main.c ../domain/product_policy.c src/my_routes.c
    tf_psa_threading/crux_tf_psa_threading.c)
zephyr_include_directories(tf_psa_threading)

# The portable usage targets of the services whose public headers this product includes, and the one
# composition interface it needs (the File root binding).
target_link_libraries(app PRIVATE crux::access crux::credential_store crux::security_event crux::web
    crux::file_zephyr crux::time crux::system)
target_compile_options(app PRIVATE -Wall -Wextra -Werror)

# The frontend folder, with index.html at its top. The Angular example replaces the one-page default with
# -DCRUX_CONSUMER_WEB_FOLDER=<dist> -DCRUX_CONSUMER_WEB_STYLE=inline (it injects styles at run time) and
# CONFIG_CRUX_WEB_RESPONSE_DEADLINE_MS=3000: see docs/web-assets.md and docs/e2e-native-220.md.
set(CRUX_CONSUMER_WEB_FOLDER "${CMAKE_CURRENT_LIST_DIR}/site" CACHE PATH "The folder to package")
set(CRUX_CONSUMER_WEB_STYLE strict CACHE STRING "strict, or inline for the Angular example")
crux_web_assets(app FOLDER ${CRUX_CONSUMER_WEB_FOLDER} STYLE ${CRUX_CONSUMER_WEB_STYLE})
# The route sources of the Crux services are not named yet: see the README, "What is missing".
crux_web_routes(app SOURCES src/my_routes.c ZEPHYR_RESOURCES REVIEWED ${CMAKE_CURRENT_LIST_DIR}/reviewed-routes.txt)
```

## prj.conf
```kconfig
# SPDX-License-Identifier: Apache-2.0
# The consumer's configuration (ADR-0004 T3). The Zephyr, network, TLS, PSA and file system symbols are the
# product's own, copied here so that this project reads nothing from inside the Crux repository. The Crux
# symbols are the service symbols and the capabilities they sit on: no Thread, Sync, Time, Queue or Serial
# symbol (the service symbols select what they link: ADR-0004 C6).

# Zephyr and the test harness.
CONFIG_ZTEST=y
CONFIG_ZTEST_VERIFY_RUN_ALL=n
CONFIG_MAIN_STACK_SIZE=32768
CONFIG_ZTEST_STACK_SIZE=32768
CONFIG_HEAP_MEM_POOL_SIZE=32768
CONFIG_STD_C17=y
# A Ztest image runs the simulated clock as fast as it can by default. Without this, the server's handshake
# timed out at 10 simulated seconds on a fast CI runner. A delayed ACK on the host's TCP stack is the likely
# cause, and it was not traced.
CONFIG_NATIVE_SIM_SLOWDOWN_TO_REAL_TIME=y

CONFIG_NETWORKING=y
CONFIG_NET_IPV4=y
CONFIG_NET_SOCKETS=y
CONFIG_NET_SOCKETS_OFFLOAD=y
CONFIG_NET_DRIVERS=y
CONFIG_NET_NATIVE_OFFLOADED_SOCKETS=y
CONFIG_ETH_NATIVE_TAP=n
CONFIG_NET_SOCKETS_SOCKOPT_TLS=y
CONFIG_TLS_CREDENTIALS=y
CONFIG_TLS_MAX_CREDENTIALS_NUMBER=4
CONFIG_NET_SOCKETS_TLS_MAX_CONTEXTS=6
CONFIG_ZVFS_OPEN_MAX=24
CONFIG_ZVFS_POLL_MAX=16
CONFIG_ZVFS_EVENTFD=y

# Test-only on native_sim. See docs/psa-crypto-design.md.
CONFIG_ENTROPY_GENERATOR=y
CONFIG_HWINFO=y


CONFIG_FILE_SYSTEM=y
CONFIG_FILE_SYSTEM_MKFS=y
CONFIG_FAT_FILESYSTEM_ELM=y
CONFIG_FS_FATFS_LFN=y
CONFIG_FS_FATFS_LFN_MODE_STACK=y
CONFIG_FS_FATFS_MAX_LFN=127
CONFIG_FS_FATFS_MOUNT_MKFS=n
CONFIG_FS_FATFS_REENTRANT=y
CONFIG_FS_FATFS_NUM_FILES=6
CONFIG_DISK_DRIVERS=y
CONFIG_DISK_DRIVER_FLASH=y
CONFIG_CRUX_FILE_FATFS_SIMULATOR=y

# The Crux Logging provider, on the emulated UART it accepts on native_sim.
CONFIG_CRUX_LOGGING=y
CONFIG_SERIAL=y
CONFIG_EMUL=y
CONFIG_UART_EMUL=y
CONFIG_LOG=y
CONFIG_LOG_MODE_DEFERRED=y
CONFIG_LOG_MODE_OVERFLOW=n
CONFIG_LOG_BLOCK_IN_THREAD=n
CONFIG_LOG_PROCESS_THREAD=y
CONFIG_LOG_PROCESS_THREAD_STACK_SIZE=2048
CONFIG_LOG_PROCESS_THREAD_CUSTOM_PRIORITY=y
CONFIG_LOG_PROCESS_THREAD_PRIORITY=14
CONFIG_LOG_BUFFER_SIZE=4096
CONFIG_LOG_MAX_LEVEL=4
CONFIG_LOG_RUNTIME_FILTERING=n
CONFIG_LOG_BACKEND_UART=y
CONFIG_LOG_BACKEND_NATIVE_POSIX=n
CONFIG_LOG_BACKEND_UART_ASYNC=n
CONFIG_LOG_PRINTK=n
CONFIG_THREAD_MONITOR=y
CONFIG_THREAD_NAME=y
CONFIG_SHELL_LOG_BACKEND=n

CONFIG_CRUX_WEB_PORT=18243
CONFIG_CRUX_WEB_REQUEST_DEADLINE_MS=2000
CONFIG_CRUX_WEB_RESPONSE_DEADLINE_MS=1500
CONFIG_CRUX_WEB_SEND_TIMEOUT_MS=500
CONFIG_HTTP_SERVER_CLIENT_INACTIVITY_TIMEOUT=3
CONFIG_MINIMAL_LIBC=y
CONFIG_CRUX_NETIF=y
CONFIG_CRUX_SYSTEM=y
CONFIG_WATCHDOG=y
CONFIG_REBOOT=y

# The Mbed profile: Mbed TLS behind the TLS sockets, on TF-PSA-Crypto (from tests/native/tls_offload_probe/mbed.conf).
# selects Mbed TLS and PSA only if NET_NATIVE. It is y in this image, and this states them all the same.
CONFIG_MBEDTLS=y
CONFIG_MBEDTLS_PSA_CRYPTO_C=y
CONFIG_PSA_CRYPTO_PROVIDER_MBEDTLS=y
CONFIG_MBEDTLS_ENABLE_HEAP=y
CONFIG_MBEDTLS_HEAP_SIZE=120000
# A client can send a whole 16 KiB record unless the server has negotiated less, so a smaller value
# loses data from a browser. The driver checks this with a 64 KiB transfer.
CONFIG_MBEDTLS_SSL_MAX_CONTENT_LEN=16384
CONFIG_MBEDTLS_SSL_PROTO_TLS1_2=y
CONFIG_MBEDTLS_SSL_PROTO_TLS1_3=y
CONFIG_MBEDTLS_SSL_TLS1_3_KEY_EXCHANGE_MODE_EPHEMERAL_ENABLED=y
CONFIG_MBEDTLS_KEY_EXCHANGE_ECDHE_ECDSA_ENABLED=y
CONFIG_MBEDTLS_CIPHERSUITE_TLS_ECDHE_ECDSA_WITH_AES_128_GCM_SHA256=y
CONFIG_MBEDTLS_CIPHERSUITE_TLS1_3_AES_128_GCM_SHA256=y
CONFIG_PSA_WANT_ALG_SHA_256=y
CONFIG_PSA_WANT_ECC_SECP_R1_256=y
CONFIG_PSA_WANT_ALG_ECDSA=y
CONFIG_PSA_WANT_ALG_ECDH=y
CONFIG_PSA_WANT_ALG_GCM=y
CONFIG_PSA_WANT_KEY_TYPE_AES=y
CONFIG_PSA_WANT_ALG_HMAC=y
CONFIG_PSA_WANT_ALG_HKDF=y
CONFIG_PSA_WANT_ALG_TLS12_PRF=y
CONFIG_PSA_WANT_KEY_TYPE_ECC_PUBLIC_KEY=y
CONFIG_PSA_WANT_KEY_TYPE_ECC_KEY_PAIR_IMPORT=y
CONFIG_PSA_WANT_KEY_TYPE_ECC_KEY_PAIR_EXPORT=y
CONFIG_PSA_WANT_KEY_TYPE_ECC_KEY_PAIR_GENERATE=y

# What the Access, store and certificate providers ask of PSA (from profile-psa.conf).
# What the Access and store providers ask of PSA, on either profile, beside what TLS asks for.
CONFIG_PSA_WANT_ALG_SHA_256=y
CONFIG_PSA_WANT_ALG_HMAC=y
CONFIG_PSA_WANT_KEY_TYPE_HMAC=y
CONFIG_PSA_WANT_ALG_PBKDF2_HMAC=y
CONFIG_PSA_WANT_ALG_GCM=y
CONFIG_PSA_WANT_KEY_TYPE_AES=y
CONFIG_PSA_WANT_ALG_ECDSA=y
CONFIG_PSA_WANT_KEY_TYPE_ECC_PUBLIC_KEY=y
CONFIG_PSA_WANT_KEY_TYPE_ECC_KEY_PAIR_IMPORT=y
CONFIG_PSA_WANT_KEY_TYPE_ECC_KEY_PAIR_EXPORT=y
CONFIG_PSA_WANT_KEY_TYPE_ECC_KEY_PAIR_GENERATE=y
CONFIG_PSA_WANT_ECC_SECP_R1_256=y

# The locks of TF-PSA-Crypto's core (from mbed-threading.conf), with the glue in tf_psa_threading/.
# Added on the Mbed profile: see composition/tf_psa_threading.
CONFIG_TF_PSA_CRYPTO_USER_CONFIG_FILE="crux_tf_psa_user_config.h"

# The Crux services of the product. Each service symbol selects the Crux Thread, Sync and Time symbols it links.
CONFIG_CRUX_ACCESS=y
CONFIG_CRUX_CONFIG_SERVICE=y
CONFIG_CRUX_MGMT_STATUS=y
# CONFIG_CRUX_NETWORK_SETTINGS=y  # pending: slice 3, PR 417, not yet on main
# CONFIG_CRUX_NETWORK_SETTINGS_NO_APPLY=y  # pending: slice 3, PR 417, not yet on main
# CONFIG_CRUX_TLS_CERTIFICATE=y  # pending: slice 3, PR 417, not yet on main
# CONFIG_CRUX_FILE_SERVICE=y  # pending: slice 3, PR 417, not yet on main
# CONFIG_CRUX_REBOOT=y  # pending: slice 3, PR 417, not yet on main
CONFIG_CRUX_WEB=y
# CONFIG_CRUX_WEB_SESSION=y  # pending: slice 4, not yet on main
# CONFIG_CRUX_WEB_MANAGEMENT=y  # pending: slice 4, not yet on main
```

## src/main.c
```c
/*
 * ADR-0004 T3. The product's execution shell: it owns the start order of the management services
 * and calls the domain (../../domain). It includes public <crux/...> headers only. What the start
 * order still needs from headers that do not exist yet is listed at each step as PENDING, with the
 * phase 1a header that will carry it, and is added when that header merges (see the README, "What
 * is missing"). Test only: the entropy is test-only.
 */
#include "../../domain/product_policy.h"
#include "crux_tf_psa_threading.h"

#include <crux/access.h>
#include <crux/credential_store.h>
#include <crux/file_zephyr.h>
#include <crux/security_event.h>
#include <crux/time.h>

/* The store's start is public with phase 1a (<crux/credential_store_start.h>, PR 419). Until that
 * header is on main this file builds without it, and the step below stays PENDING. */
#if __has_include(<crux/credential_store_start.h>)
#include <crux/credential_store_start.h>
#define CONSUMER_HAS_CREDENTIAL_START 1
#else
#define CONSUMER_HAS_CREDENTIAL_START 0
#endif

#include <ff.h>
#include <zephyr/fs/fs.h>
#include <zephyr/ztest.h>

enum { ROOT_SLOT_A = 1, ROOT_SLOT_B = 2 };
#define MOUNT_POINT "/SD:"
#define DISK_NAME "SD:"
#define PATH_SLOT_A MOUNT_POINT "/secure-a"
#define PATH_SLOT_B MOUNT_POINT "/secure-b"

static FATFS fat;
static struct fs_mount_t mount = {
    .type = FS_FATFS,
    .mnt_point = MOUNT_POINT,
    .fs_data = &fat,
    .flags = FS_MOUNT_FLAG_NO_FORMAT,
};
static const crux_access_session_t never_valid = {0};

static bool directory_ready(const char *path)
{
    int result = fs_mkdir(path);
    return result == 0 || result == -EEXIST;
}

/* Step 2 of the start order: the File roots, through the public composition interface
 * <crux/file_zephyr.h>. */
static bool medium_ready(void)
{
    if (fs_mount(&mount) != 0) {
        if (fs_mkfs(FS_FATFS, (uintptr_t)DISK_NAME, NULL, 0) != 0 || fs_mount(&mount) != 0) {
            return false;
        }
    }
    return directory_ready(PATH_SLOT_A) && directory_ready(PATH_SLOT_B) &&
           crux_file_zephyr_bind_root(ROOT_SLOT_A, PATH_SLOT_A) == CRUX_FILE_OK &&
           crux_file_zephyr_bind_root(ROOT_SLOT_B, PATH_SLOT_B) == CRUX_FILE_OK;
}

static void *start_services(void)
{
    /* Step 1. */
    zassert_equal(crux_security_event_init(NULL, 0), CRUX_OK);
    zassert_equal(crux_realtime_init(), CRUX_OK);
    zassert_true(medium_ready());
    /* Step 3. PENDING until <crux/credential_store_start.h> is on main. */
#if CONSUMER_HAS_CREDENTIAL_START
    crux_credential_result_t store = crux_credential_start(ROOT_SLOT_A, ROOT_SLOT_B);
    zassert_true(store == CRUX_CREDENTIAL_OK || store == CRUX_CREDENTIAL_ERR_UNUSABLE);
#endif
    /* Step 4. Without the store started, Access answers NOT_READY and stays so: it fails closed. */
    crux_access_result_t access = crux_access_init(product_policy());
    zassert_true(access == CRUX_ACCESS_OK || access == CRUX_ACCESS_ERR_NOT_READY);
    /* Steps 5 and 6, PENDING: the Configuration, status, network settings, file and reboot services
     * have public headers but no usage target yet (crux::config_service and the others, phase 1a).
     */
    zassert_equal(crux_security_event_start(), CRUX_OK);
    /* Steps 7 to 10, PENDING: the first account, the TLS certificate, the web session and
     * management lifecycle and crux_web_start() need the phase 1a headers (the TLS certificate, the
     * apply port, the web lifecycle and web_zephyr). */
    return NULL;
}

ZTEST_SUITE(consumer_composition, NULL, start_services, NULL, NULL, NULL);

ZTEST(consumer_composition,
      test_01_access_is_linked_from_the_module_and_refuses_a_session_that_never_was)
{
    zassert_equal(crux_access_check(never_valid, PRODUCT_PERMISSION_DEMO),
                  CRUX_ACCESS_ERR_SESSION_INVALID);
}

ZTEST(consumer_composition, test_02_the_store_state_is_readable_from_its_public_header)
{
    crux_credential_store_info_t info;
    crux_status_t status = crux_credential_store_get_info(&info);
#if CONSUMER_HAS_CREDENTIAL_START
    /* Started on a fresh disk: nothing is stored yet. */
    zassert_equal(status, CRUX_OK);
    zassert_equal(info.state, CRUX_CREDENTIAL_STATE_EMPTY);
#else
    zassert_equal(status, CRUX_ERR_NOT_READY);
#endif
}
```

## src/my_routes.c
```c
/* The product's own route. It uses the public header <crux/web.h> only. */
#include <crux/web.h>

static crux_web_result_t on_ping(crux_web_request_t *request, crux_access_session_t session,
                                 void *context)
{
    (void)session;
    (void)context;
    return crux_web_respond(request, 200, "text/plain", "pong", 4u);
}

/* A permission as the access class: the route is not on the reviewed list of public and
 * session-only routes. */
CRUX_WEB_ROUTE(product_ping, "/api/v1/product/ping", CRUX_WEB_GET, "product.demo", on_ping, NULL);
```
