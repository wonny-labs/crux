## tests/controller_probe/dts/bindings/gpio/vnd,controller-fault-gpio.yaml
```yaml
description: Test-only GPIO API fixture for a controlled negative native read
compatible: "vnd,controller-fault-gpio"
include: gpio-controller.yaml
gpio-cells:
  - pin
  - flags
```

## tests/controller_probe/testcase.yaml
```yaml
common:
  harness: ztest
  platform_allow:
    - native_sim/native/64
  integration_platforms:
    - native_sim/native/64
  tags:
    - crux
    - gpio
    - health
tests:
  crux.controller.gpio_health:
    extra_args:
      - DTC_OVERLAY_FILE=boards/native_sim.overlay
      - CT_GPIO_SCENARIO=emulated
  crux.controller.missing_gpio:
    extra_args:
      - DTC_OVERLAY_FILE=boards/native_sim.overlay
      - CT_GPIO_SCENARIO=missing
      - EXTRA_DTC_OVERLAY_FILE=boards/missing_button.overlay
  crux.controller.read_error:
    extra_args:
      - DTC_OVERLAY_FILE=boards/native_sim.overlay
      - CT_GPIO_SCENARIO=fault
      - EXTRA_DTC_OVERLAY_FILE=boards/fault_gpio.overlay
```

## tests/integrated_smoke/zephyr/testcase.yaml
```yaml
tests:
  crux.integrated_smoke:
    platform_allow:
      - native_sim/native/64
    tags:
      - netphys
      - integration
      - portable
    harness: ztest
    timeout: 30
```

## tests/logging/zephyr/testcase.yaml
```yaml
tests:
  crux.logging:
    platform_allow:
      - native_sim/native/64
    tags:
      - logging
      - portable
  crux.logging.native_pty:
    platform_allow:
      - native_sim/native/64
    tags:
      - logging
    extra_args:
      - CONF_FILE=native_pty.conf
      - DTC_OVERLAY_FILE=native_pty.overlay
      - CRUX_LOGGING_NATIVE_PTY=ON
    harness: console
    harness_config:
      type: multi_line
      ordered: true
      regex:
        - "<inf> crux_logging: pty: record on the native UART"
        - "printk after the record"
```

## tests/native/configuration_settings_littlefs/testcase.yaml
```yaml
tests:
  crux.configuration.settings_littlefs:
    platform_allow: [native_sim/native/64]
    tags: [settings, filesystem, crux]
    timeout: 180
```

## tests/native/credential_littlefs/testcase.yaml
```yaml
tests:
  crux.credential.littlefs_blk:
    platform_allow: [native_sim/native, native_sim/native/64]
    tags: [filesystem, crux]
    timeout: 180
```

## tests/time_periodic/zephyr/testcase.yaml
```yaml
tests:
  crux.time_periodic.scenario:
    tags: [crux, scenario]
    platform_allow:
      - native_sim/native/64
      - mimxrt1060_evk@B/mimxrt1062/qspi
    integration_platforms:
      - native_sim/native/64
    harness: console
    harness_config:
      type: multi_line
      ordered: true
      regex:
        - "controller composition=zephyr init=0"
        - "CONTROLLER_COMPLETE cycles=20"
```

## tests/zephyr/file_fatfs_compile/testcase.yaml
```yaml
tests:
  crux.file.fatfs_sdmmc_compile:
    build_only: true
    platform_allow: [mimxrt1060_evk@B/mimxrt1062/qspi]
    integration_platforms: [mimxrt1060_evk@B/mimxrt1062/qspi]
    tags: [filesystem, crux, compile_only]
```

## tests/zephyr/file_littlefs_link/testcase.yaml
```yaml
tests:
  crux.file.littlefs_blk_link_rt1060:
    build_only: true
    platform_allow: [mimxrt1060_evk@B/mimxrt1062/qspi]
    integration_platforms: [mimxrt1060_evk@B/mimxrt1062/qspi]
    tags: [filesystem, settings, crux, compile_only]
```
