/* SPDX-License-Identifier: Apache-2.0 */
/* A RAM disk named like the eMMC disk: 1 MiB of 512-byte sectors, so that a case that fills the
 * volume stays short. */
/ {
    ramdisk0 {
        compatible = "zephyr,ram-disk";
        disk-name = "MMC";
        sector-size = <512>;
        sector-count = <2048>;
    };
};
