## CMakeLists.txt
```
# SPDX-License-Identifier: Apache-2.0
cmake_minimum_required(VERSION 3.20.0)
find_package(Zephyr REQUIRED HINTS $ENV{ZEPHYR_BASE})
project(crux_web_http_native LANGUAGES C)
if(NOT CONFIG_BOARD_NATIVE_SIM)
  message(FATAL_ERROR "This suite is restricted to native_sim, and it operates no hardware")
endif()
get_filename_component(CRUX_ROOT "${CMAKE_CURRENT_LIST_DIR}/../../.." ABSOLUTE)
include(${CRUX_ROOT}/cmake/CruxConsumerBoundary.cmake)
include(${CRUX_ROOT}/cmake/CruxWebRoutes.cmake)

# A project's route: it compiles against crux::web alone, with no Zephyr requirement.
add_library(web_project_routes STATIC src/project_routes.c)
target_link_libraries(web_project_routes PRIVATE crux::web)
target_compile_options(web_project_routes PRIVATE -Wall -Wextra -Werror)
crux_assert_portable_consumer(web_project_routes)

target_sources(app PRIVATE src/main.c src/probe_routes.c src/access_double.c src/upload_probe.c
  src/socket_shim.c)
target_sources(native_simulator INTERFACE ${CMAKE_CURRENT_LIST_DIR}/src/host_socket.c)
target_link_options(app PUBLIC -Wl,--wrap=z_impl_zsock_shutdown -Wl,--wrap=z_impl_zsock_sendto
  -Wl,--wrap=z_impl_zsock_sendmsg)
target_link_libraries(app PRIVATE crux_web_adapter web_project_routes)
target_compile_options(app PRIVATE -Wall -Wextra -Werror)
crux_web_routes(app SOURCES src/probe_routes.c src/project_routes.c ZEPHYR_RESOURCES
  REVIEWED reviewed-routes.txt)
```

## prj.conf
```kconfig
# The adapter over the real server, on the native socket offload and plain HTTP. TLS is Issue #185.
CONFIG_NETWORKING=y
CONFIG_NET_IPV4=y
CONFIG_NET_IPV6=n
CONFIG_NET_TCP=y
CONFIG_NET_SOCKETS=y
CONFIG_NET_DRIVERS=y
CONFIG_NET_SOCKETS_OFFLOAD=y
CONFIG_NET_NATIVE_OFFLOADED_SOCKETS=y
CONFIG_ETH_NATIVE_TAP=n
# The host's C library takes Zephyr's fnmatch flags with other meanings, so the server's wildcard pass
# would not behave as on a target. This selects Zephyr's own fnmatch.
CONFIG_MINIMAL_LIBC=y
CONFIG_ZVFS_OPEN_MAX=16
CONFIG_ZVFS_POLL_MAX=16

CONFIG_CRUX_WEB=y
CONFIG_CRUX_WEB_PLAIN_HTTP_FOR_TESTS=y
CONFIG_CRUX_WEB_PORT=18184
# A valid bind text, which the server takes. bad-bind.conf holds one that it would not.
CONFIG_CRUX_WEB_BIND_ADDRESS="127.0.0.1"
# Shortened so that the measurements finish quickly. The results scale with these.
CONFIG_HTTP_SERVER_CLIENT_INACTIVITY_TIMEOUT=3
CONFIG_CRUX_WEB_REQUEST_DEADLINE_MS=2000
CONFIG_CRUX_WEB_HEADER_DEADLINE_MS=2000
CONFIG_CRUX_WEB_SEND_TIMEOUT_MS=500
CONFIG_CRUX_WEB_RESPONSE_DEADLINE_MS=1500

CONFIG_NATIVE_SIM_SLOWDOWN_TO_REAL_TIME=y
CONFIG_HEAP_MEM_POOL_SIZE=16384
CONFIG_MAIN_STACK_SIZE=4096
CONFIG_LOG=n
```

## bad-bind.conf
```kconfig
# A bind text that is not an address of an enabled family. The Zephyr server would listen on every
# address for it, so crux_web_start() must refuse it. scripts/test-web.sh builds the suite with this
# file as well and expects the start to fail.
CONFIG_CRUX_WEB_BIND_ADDRESS="127.0.0.300"
```

## src/main.c
```c
/* Starts the adapter on plain HTTP over the native socket offload. test_driver.py is the client. */
#include "web_probe.h"

#include <zephyr/kernel.h>

int main(void)
{
    static const crux_web_config_t config = {
        .authenticate = web_probe_authenticate,
        .request_deadline_ms = CONFIG_CRUX_WEB_REQUEST_DEADLINE_MS,
        .handler_limit_ms = 100u,
    };

    web_probe_fill_large_body();
    if (crux_web_start(&config) != CRUX_WEB_OK) {
        printk("CRUX_WEB_START_FAILED\n");
        return 1;
    }
    printk("CRUX_WEB_READY %d\n", CONFIG_CRUX_WEB_PORT);
    web_probe_serve_second_start(&config);
    return 0;
}
```

## src/probe_routes.c
```c
/* The API's shape for the driver, plus probes that measure the server thread. Not for a product. */
#include "web_probe.h"

#include <crux/web.h>
#include <stdio.h>
#include <stdlib.h>
#include <string.h>
#include <zephyr/kernel.h>

#define LARGE_BODY_SIZE (8u * 1024u * 1024u)
static uint8_t large_body[LARGE_BODY_SIZE];

void web_probe_fill_large_body(void)
{
    for (size_t index = 0; index < sizeof(large_body); ++index) {
        large_body[index] = (uint8_t)('a' + index % 26u);
    }
}

static crux_web_result_t respond_json(crux_web_request_t *request, const char *route)
{
    char body[96];
    int length = snprintf(body, sizeof(body), "{\"route\":\"%s\",\"body\":%zu}", route,
                          crux_web_body_length(request));

    return crux_web_respond(request, 200, NULL, body, (size_t)length);
}

static crux_web_result_t on_named(crux_web_request_t *request, crux_access_session_t session,
                                  void *context)
{
    (void)session;
    return respond_json(request, (const char *)context);
}

static crux_web_result_t on_attempt(crux_web_request_t *request, crux_access_session_t session,
                                    void *context)
{
    char id[64];
    char query[64];
    char body[192];
    int length;

    (void)session;
    (void)context;
    if (crux_web_path_param(request, 0u, id, sizeof(id)) != CRUX_WEB_OK ||
        crux_web_query(request, query, sizeof(query)) != CRUX_WEB_OK) {
        return crux_web_respond_error(request, 404, "not_found");
    }
    length = snprintf(body, sizeof(body), "{\"route\":\"attempt\",\"id\":\"%s\",\"query\":\"%s\"}",
                      id, query);
    return crux_web_respond(request, 200, NULL, body, (size_t)length);
}

/* The lengths of what the capture held, so the driver can size it without any value coming back. */
static crux_web_result_t on_echo(crux_web_request_t *request, crux_access_session_t session,
                                 void *context)
{
    const crux_web_request_head_t *head = crux_web_request_head(request);
    char body[256];
    int length;

#define LENGTH_OF(field) (head->field != NULL ? (int)strlen(head->field) : -1)
    (void)session;
    (void)context;
    length = snprintf(body, sizeof(body),
                      "{\"cookie\":%d,\"origin\":%d,\"host\":%d,\"xsrf\":%d,\"request\":%d,"
                      "\"type\":%d,\"length\":%d,\"body\":%zu}",
                      LENGTH_OF(cookie), LENGTH_OF(origin), LENGTH_OF(host), LENGTH_OF(xsrf_token),
                      LENGTH_OF(crux_request), LENGTH_OF(content_type), LENGTH_OF(content_length),
                      crux_web_body_length(request));
#undef LENGTH_OF
    return crux_web_respond(request, 200, NULL, body, (size_t)length);
}

/* Sets cookies of the size that #186 will: 256 bits in base64url, for the real-browser run. */
static crux_web_result_t on_browser_cookies(crux_web_request_t *request,
                                            crux_access_session_t session, void *context)
{
    (void)session;
    (void)context;
    if (crux_web_add_header(request, "Set-Cookie",
                            "crux_session=admin000000000000000000000000000000000000000; Secure; "
                            "HttpOnly; SameSite=Strict; Path=/") != CRUX_WEB_OK ||
        crux_web_add_header(request, "Set-Cookie",
                            "XSRF-TOKEN=0000000000000000000000000000000000000000000; Secure; "
                            "SameSite=Strict; Path=/") != CRUX_WEB_OK) {
        return CRUX_WEB_ERR_FAILED;
    }
    return crux_web_respond(request, 200, NULL, "{}", 2u);
}

static crux_web_result_t on_slow(crux_web_request_t *request, crux_access_session_t session,
                                 void *context)
{
    char text[12];

    (void)session;
    (void)context;
    if (crux_web_path_param(request, 0u, text, sizeof(text)) != CRUX_WEB_OK) {
        return crux_web_respond_error(request, 404, "not_found");
    }
    k_msleep(atoi(text));
    return respond_json(request, "slow");
}

/* Bodies of a chosen size, sent in pieces by the adapter. The security headers are the caller's. */
static crux_web_result_t on_static(crux_web_request_t *request, crux_access_session_t session,
                                   void *context)
{
    static const crux_web_header_t headers[] = {
        {"Content-Type", "application/octet-stream"},
        {"X-Content-Type-Options", "nosniff"},
    };
    char text[12];

    (void)session;
    (void)context;
    if (crux_web_path_param(request, 0u, text, sizeof(text)) != CRUX_WEB_OK) {
        return crux_web_respond_error(request, 404, "not_found");
    }
    return crux_web_respond_static(request, 200, headers, 2u, large_body,
                                   MIN((size_t)atoi(text), sizeof(large_body)));
}

/* A page for a real browser, whose script makes the requests a client makes, as the page itself. */
static crux_web_result_t on_page(crux_web_request_t *request, crux_access_session_t session,
                                 void *context)
{
    static const char page[] = "<!doctype html><title>probe</title><pre id=out></pre>"
                               "<script src=/probe/page.js></script>";

    (void)session;
    (void)context;
    return crux_web_respond(request, 200, "text/html", page, sizeof(page) - 1u);
}

static crux_web_result_t on_page_script(crux_web_request_t *request, crux_access_session_t session,
                                        void *context)
{
    static const char script[] =
        "(async () => {\n"
        "  const out = document.getElementById('out');\n"
        "  try {\n"
        "    const token = document.cookie.split('; ').find(c => c.startsWith('XSRF-TOKEN='));\n"
        "    const post = await fetch('/probe/echo', {method: 'POST', headers: {\n"
        "      'Content-Type': 'application/json', 'X-XSRF-TOKEN': token.split('=')[1],\n"
        "      'X-Crux-Request': '1'}, body: '{}'});\n"
        "    const postBody = await post.json();\n"
        "    const get = await fetch('/probe/echo', {headers: {'X-Crux-Request': '1'}});\n"
        "    const getBody = await get.json();\n"
        "    const parallel = await Promise.all(Array.from({length: 8}, (_, i) =>\n"
        "      fetch('/probe/stats?' + i).then(r => r.status)));\n"
        "    out.textContent = JSON.stringify({userAgent: navigator.userAgent,\n"
        "      postStatus: post.status, post: postBody, get: getBody, parallel});\n"
        "  } catch (e) {\n"
        "    out.textContent = JSON.stringify({error: String(e)});\n"
        "  }\n"
        "})();\n";

    (void)session;
    (void)context;
    return crux_web_respond(request, 200, "text/javascript", script, sizeof(script) - 1u);
}

/* A response in pieces, whose chosen send returns -EAGAIN as a stalled reader's would. */
static crux_web_result_t on_fail(crux_web_request_t *request, crux_access_session_t session,
                                 void *context)
{
    static uint8_t body[4096];
    char text[12];

    (void)session;
    (void)context;
    if (crux_web_path_param(request, 0u, text, sizeof(text)) != CRUX_WEB_OK) {
        return crux_web_respond_error(request, 404, "not_found");
    }
    memset(body, 'A', sizeof(body));
    web_probe_fail_send_after((unsigned)atoi(text));
    return crux_web_respond(request, 200, "text/plain", body, sizeof(body));
}

/* Another client's response, through the one shared buffer. */
static crux_web_result_t on_other(crux_web_request_t *request, crux_access_session_t session,
                                  void *context)
{
    static uint8_t body[4096];

    (void)session;
    (void)context;
    memset(body, 'B', sizeof(body));
    return crux_web_respond(request, 200, "text/plain", body, sizeof(body));
}

static crux_web_result_t on_send_buffer(crux_web_request_t *request, crux_access_session_t session,
                                        void *context)
{
    char text[12];

    (void)session;
    (void)context;
    if (crux_web_path_param(request, 0u, text, sizeof(text)) != CRUX_WEB_OK) {
        return crux_web_respond_error(request, 404, "not_found");
    }
    web_probe_set_next_send_buffer(atoi(text));
    return crux_web_respond(request, 200, NULL, "{}", 2u);
}

static crux_web_result_t on_stats(crux_web_request_t *request, crux_access_session_t session,
                                  void *context)
{
    crux_web_stats_t stats;
    char body[256];
    int length;

    (void)session;
    (void)context;
    crux_web_stats_get(&stats);
    length = snprintf(body, sizeof(body),
                      "{\"requests\":%u,\"rejected\":%u,\"handlers\":%u,\"deadlines\":%u,"
                      "\"response_deadlines\":%u,"
                      "\"aborted\":%u,\"overruns\":%u,\"handler_max_ms\":%u,\"send_eagain\":%u}",
                      stats.requests, stats.rejected, stats.handlers, stats.deadlines,
                      stats.response_deadlines, stats.aborted, stats.handler_overruns,
                      stats.handler_max_ms, web_probe_eagain_count());
    return crux_web_respond(request, 200, NULL, body, (size_t)length);
}

/* A second crux_web_start() while this request is open. The main thread makes the call, in
 * web_probe_serve_second_start(), and this handler waits for it on the server thread. */
static K_SEM_DEFINE(second_start_requested, 0, 1);
static K_SEM_DEFINE(second_start_done, 0, 1);
static crux_web_result_t second_start_result;

static crux_web_result_t on_second_start(crux_web_request_t *request, crux_access_session_t session,
                                         void *context)
{
    char body[48];
    int length;

    (void)session;
    (void)context;
    k_sem_reset(&second_start_done);
    k_sem_give(&second_start_requested);
    if (k_sem_take(&second_start_done, K_SECONDS(5)) != 0) {
        length = snprintf(body, sizeof(body), "{\"second_start\":\"timeout\"}");
    } else {
        length = snprintf(body, sizeof(body), "{\"second_start\":%d}", (int)second_start_result);
    }
    return crux_web_respond(request, 200, NULL, body, (size_t)length);
}

void web_probe_serve_second_start(const crux_web_config_t *config)
{
    for (;;) {
        (void)k_sem_take(&second_start_requested, K_FOREVER);
        second_start_result = crux_web_start(config);
        k_sem_give(&second_start_done);
    }
}

CRUX_WEB_ROUTE(login, "/api/v1/session", CRUX_WEB_POST, CRUX_WEB_PUBLIC, on_named, "login");
CRUX_WEB_ROUTE(logout, "/api/v1/session", CRUX_WEB_DELETE, CRUX_WEB_SESSION, on_named, "logout");
CRUX_WEB_ROUTE(attempt, "/api/v1/session/attempt/{id}", CRUX_WEB_GET, CRUX_WEB_PUBLIC, on_attempt,
               NULL);
CRUX_WEB_ROUTE(me, "/api/v1/session/me", CRUX_WEB_GET, CRUX_WEB_SESSION, on_named, "me");
CRUX_WEB_ROUTE(status, "/api/v1/status", CRUX_WEB_GET, CRUX_WEB_SESSION, on_named, "status");
CRUX_WEB_ROUTE(network_read, "/api/v1/network", CRUX_WEB_GET, "network.read", on_named,
               "network_read");
CRUX_WEB_ROUTE(network_write, "/api/v1/network", CRUX_WEB_PUT, "network.write", on_named,
               "network_write");
CRUX_WEB_ROUTE(file_list, "/api/v1/files/{area}", CRUX_WEB_GET, CRUX_WEB_SESSION, on_named,
               "file_list");
CRUX_WEB_ROUTE(file_item, "/api/v1/files/{area}/{name}", CRUX_WEB_GET, CRUX_WEB_SESSION, on_named,
               "file_item");
CRUX_WEB_ROUTE(echo_get, "/probe/echo", CRUX_WEB_GET, CRUX_WEB_PUBLIC, on_echo, NULL);
CRUX_WEB_ROUTE(echo_post, "/probe/echo", CRUX_WEB_POST, CRUX_WEB_PUBLIC, on_echo, NULL);
CRUX_WEB_ROUTE(browser_cookies, "/probe/cookies", CRUX_WEB_GET, CRUX_WEB_PUBLIC, on_browser_cookies,
               NULL);
CRUX_WEB_ROUTE(slow, "/probe/slow/{ms}", CRUX_WEB_GET, CRUX_WEB_PUBLIC, on_slow, NULL);
CRUX_WEB_ROUTE(static_body, "/probe/static/{size}", CRUX_WEB_GET, CRUX_WEB_PUBLIC, on_static, NULL);
CRUX_WEB_ROUTE(page, "/probe/page", CRUX_WEB_GET, CRUX_WEB_PUBLIC, on_page, NULL);
CRUX_WEB_ROUTE(page_script, "/probe/page.js", CRUX_WEB_GET, CRUX_WEB_PUBLIC, on_page_script, NULL);
CRUX_WEB_ROUTE(fail, "/probe/fail/{skip}", CRUX_WEB_GET, CRUX_WEB_PUBLIC, on_fail, NULL);
CRUX_WEB_ROUTE(other, "/probe/other", CRUX_WEB_GET, CRUX_WEB_PUBLIC, on_other, NULL);
CRUX_WEB_ROUTE(send_buffer, "/probe/send-buffer/{bytes}", CRUX_WEB_GET, CRUX_WEB_PUBLIC,
               on_send_buffer, NULL);
CRUX_WEB_ROUTE(stats, "/probe/stats", CRUX_WEB_GET, CRUX_WEB_PUBLIC, on_stats, NULL);
CRUX_WEB_ROUTE(second_start, "/probe/second-start", CRUX_WEB_GET, CRUX_WEB_PUBLIC, on_second_start,
               NULL);
```

## src/socket_shim.c
```c
/* Two things this test image does at the socket call that the server makes.
 *
 * The server's inactivity timer closes a client with zsock_shutdown(), and the native socket
 * offload at v4.5.0 has no shutdown operation, so there the call fails and the timer does nothing.
 * This gives the timer the effect it has on Zephyr's own TCP stack, so that the measurements mean
 * something.
 *
 * The offload's send waits out a timeout and then sends anyway, so the server rarely sees -EAGAIN,
 * which it swallows and which leaves a client held. A probe route can make one chosen send return
 * it, and can shrink a socket's send buffer, as on a small target.
 *
 * Over TLS the server's descriptor is a TLS socket, which holds the offloaded one, and the TLS
 * layer calls these again for it. A shutdown goes on to that socket, a send counts and fails only
 * at the outermost call, which is the server's, and a send buffer applies to the offloaded socket.
 *
 * It is here and not in the adapter because a product does not use the offload.
 */
#include "web_probe.h"

#include <errno.h>
#include <zephyr/kernel.h>
#include <zephyr/net/socket.h>
#include <zephyr/sys/fdtable.h>

#if defined(CONFIG_NET_SOCKETS_SOCKOPT_TLS)
bool net_socket_is_tls(void *obj);
#else
#define net_socket_is_tls(obj) false
#endif

int web_host_shutdown(int host_fd, int how);
int web_host_set_send_buffer(int host_fd, int size);
int __real_z_impl_zsock_shutdown(int sock, int how);
int __wrap_z_impl_zsock_shutdown(int sock, int how);
ssize_t __real_z_impl_zsock_sendto(int sock, const void *buf, size_t len, int flags,
                                   const struct net_sockaddr *dest_addr, net_socklen_t addrlen);
ssize_t __wrap_z_impl_zsock_sendto(int sock, const void *buf, size_t len, int flags,
                                   const struct net_sockaddr *dest_addr, net_socklen_t addrlen);
ssize_t __real_z_impl_zsock_sendmsg(int sock, const struct net_msghdr *msg, int flags);
ssize_t __wrap_z_impl_zsock_sendmsg(int sock, const struct net_msghdr *msg, int flags);

/* The start of the driver's private struct nsos_socket at v4.5.0, up to the host descriptor. A
 * wrong layout makes the host call fail, and the driver's inactivity cases then fail. */
struct nsos_socket_start {
    int fd;
    k_timeout_t recv_timeout;
    k_timeout_t send_timeout;
    struct {
        int fd;
        short events;
        short revents;
        void (*cb)(void *pollfd_mid);
    } poll_mid;
};

static bool fail_armed;
static unsigned fail_skip;
static int shrink_size;
static unsigned eagain_count;
static unsigned send_depth;
static unsigned outer_sends;
static unsigned inner_sends;
static unsigned real_eagain;

int __wrap_z_impl_zsock_shutdown(int sock, int how)
{
    const struct nsos_socket_start *socket = zvfs_get_fd_obj(sock, NULL, EBADF);

    if (socket == NULL) {
        return -1;
    }
    if (net_socket_is_tls((void *)socket)) {
        return __real_z_impl_zsock_shutdown(sock, how);
    }
    return web_host_shutdown(socket->poll_mid.fd, how);
}

/* Counts one send. A piece (one sendmsg() of a response, from Zephyr v4.5.0) may be made to fail
 * with -EAGAIN; a header block flushed with sendto() is counted but never failed. Returns false
 * when it failed the send. */
static bool send_enter(int sock, bool piece)
{
    const struct nsos_socket_start *socket = zvfs_get_fd_obj(sock, NULL, EBADF);

    if (shrink_size != 0 && socket != NULL && !net_socket_is_tls((void *)socket)) {
        (void)web_host_set_send_buffer(socket->poll_mid.fd, shrink_size);
        shrink_size = 0;
    }
    if (send_depth == 0u) {
        ++outer_sends;
        if (fail_armed && piece) {
            if (fail_skip == 0u) {
                fail_armed = false;
                ++eagain_count;
                errno = EAGAIN;
                return false;
            }
            --fail_skip;
        }
    } else {
        ++inner_sends;
    }
    ++send_depth;
    return true;
}

static void send_leave(ssize_t sent)
{
    --send_depth;
    if (send_depth == 0u && sent < 0 && errno == EAGAIN) {
        ++real_eagain;
    }
}

/* From Zephyr v4.5.0 the server passes the rest of a response's header block, a chunk and the
 * terminator to the socket in one sendmsg(), one call for each piece of the body. */
ssize_t __wrap_z_impl_zsock_sendmsg(int sock, const struct net_msghdr *msg, int flags)
{
    ssize_t sent;

    if (!send_enter(sock, true)) {
        return -1;
    }
    sent = __real_z_impl_zsock_sendmsg(sock, msg, flags);
    send_leave(sent);
    return sent;
}

ssize_t __wrap_z_impl_zsock_sendto(int sock, const void *buf, size_t len, int flags,
                                   const struct net_sockaddr *dest_addr, net_socklen_t addrlen)
{
    ssize_t sent;

    if (!send_enter(sock, false)) {
        return -1;
    }
    sent = __real_z_impl_zsock_sendto(sock, buf, len, flags, dest_addr, addrlen);
    send_leave(sent);
    return sent;
}

void web_probe_fail_send_after(unsigned skip)
{
    fail_skip = skip;
    fail_armed = true;
}

void web_probe_set_next_send_buffer(int size)
{
    shrink_size = size;
}

unsigned web_probe_eagain_count(void)
{
    return eagain_count;
}

unsigned web_probe_outer_sends(void)
{
    return outer_sends;
}

unsigned web_probe_inner_sends(void)
{
    return inner_sends;
}

unsigned web_probe_real_eagain(void)
{
    return real_eagain;
}
```

## src/web_probe.h
```c
/* Shared by the native_sim application's files. */
#ifndef WEB_PROBE_H
#define WEB_PROBE_H

#include "crux_web_adapter.h"

crux_web_auth_t web_probe_authenticate(const crux_web_request_head_t *head,
                                       crux_access_session_t *session, void *context);
void web_probe_fill_large_body(void);
/* On the main thread after a successful start: makes the second crux_web_start() that the route
 * /probe/second-start asks for, each time it asks. Never returns. */
void web_probe_serve_second_start(const crux_web_config_t *config);
/* The socket shim, on the server thread. After @p skip more sends, one send returns -EAGAIN. */
void web_probe_fail_send_after(unsigned skip);
void web_probe_set_next_send_buffer(int size);
unsigned web_probe_eagain_count(void);
/* Sends the server made, and over TLS, those the TLS layer made beneath them. */
unsigned web_probe_outer_sends(void);
unsigned web_probe_inner_sends(void);
/* Sends of the server's that returned -EAGAIN of themselves, not injected. */
unsigned web_probe_real_eagain(void);

#endif /* WEB_PROBE_H */
```
