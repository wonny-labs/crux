## CMakeLists.txt
```
# SPDX-License-Identifier: Apache-2.0
# ADR-0005 T3: a product outside the Crux repository that uses only the public System service on native_sim.
# Build it from a copy outside the repository (scripts/test-consumer-system.sh does), with
#   west build -b native_sim/native/64 <this directory> -- -DZEPHYR_EXTRA_MODULES=<crux checkout>
# Nothing here names a file inside the Crux repository: the product links one crux:: target and includes
# <crux/...> headers.
cmake_minimum_required(VERSION 3.20.0)
find_package(Zephyr REQUIRED HINTS $ENV{ZEPHYR_BASE})
project(consumer_system LANGUAGES C)

target_sources(app PRIVATE src/main.c)
target_link_libraries(app PRIVATE crux::system)
target_compile_options(app PRIVATE -Wall -Wextra -Werror)
```

## prj.conf
```kconfig
# SPDX-License-Identifier: Apache-2.0
# The product's configuration (ADR-0005 T3). The Crux symbol is CRUX_SYSTEM. What it composes on, and the
# simulated watchdog, are in boards/native_sim_native_64.conf, because they hold on native_sim only.
CONFIG_STD_C17=y
CONFIG_PRINTK=y
CONFIG_MAIN_STACK_SIZE=4096
CONFIG_BOOT_BANNER=n
# Time defaults on where an RTC exists, as on native_sim. This product does not use it.
CONFIG_CRUX_TIME=n
CONFIG_CRUX_SYSTEM=y
```

## boards/native_sim_native_64.conf
```kconfig
# SPDX-License-Identifier: Apache-2.0
# The native_sim fragment of the product (ADR-0005 section 3): the three native facilities that System
# composes on, and the simulated watchdog, an Experimental native_sim test setting. The symbol is refused at
# configure time on every other board. A simulated watchdog is not hardware evidence.
CONFIG_WATCHDOG=y
CONFIG_HWINFO=y
CONFIG_REBOOT=y
CONFIG_CRUX_SYSTEM_NATIVE_SIM_WATCHDOG=y
```

## src/main.c
```c
/* SPDX-License-Identifier: Apache-2.0 */
/* ADR-0005 T3: the consumer scenario of the simulated System watchdog, as a product outside the
 * Crux repository writes it. It uses the public System service only (<crux/system.h>,
 * <crux/status.h>), and Zephyr for its own execution shell (sleep and console). A simulated
 * watchdog is not hardware evidence.
 *
 * Boot 1 (cause POR): read and clear the cause, start the watchdog, feed it past one timeout, then
 * stop feeding. The simulated device restarts the process (CONFIG_NATIVE_SIM_REBOOT). Boot 2 (cause
 * SOFTWARE, never WATCHDOG on native_sim): tell it apart from boot 1, find a fresh state, start the
 * watchdog again and keep feeding. Arming order and loop policy belong to the product: without this
 * feed the restart would repeat until the harness timeout. */
#include <crux/status.h>
#include <crux/system.h>
#include <zephyr/kernel.h>
#include <zephyr/sys/printk.h>

#define TIMEOUT_MS 2000
#define FEED_PERIOD_MS 500
#define FEEDS 6

static void fail(const char *what) FUNC_NORETURN;
static void fail(const char *what)
{
    printk("simwdt: FAIL %s\n", what);
    /* A fatal error ends the run at once, so a failure is not mistaken for a timeout. */
    k_panic();
    for (;;) {
    }
}

static void expect(bool condition, const char *what)
{
    if (!condition) {
        fail(what);
    }
}

static void expect_state(crux_watchdog_state_t state, const char *what)
{
    crux_system_status_t status;
    expect(crux_system_status_get(&status) == CRUX_OK, "status get");
    expect(status.watchdog_emulated, "watchdog_emulated");
    expect(status.watchdog_state == state, what);
    expect(state != CRUX_WATCHDOG_ACTIVE ||
               (status.watchdog_status == CRUX_OK && status.watchdog_timeout_ms == TIMEOUT_MS),
           "active status and timeout");
}

static uint32_t read_and_clear_cause(void)
{
    crux_reset_cause_t cause;
    expect(crux_system_reset_cause_get(&cause) == CRUX_OK, "cause get");
    expect((cause.causes & CRUX_RESET_CAUSE_WATCHDOG) == 0,
           "WATCHDOG bit unsupported on native_sim");
    expect((cause.supported & CRUX_RESET_CAUSE_WATCHDOG) == 0, "WATCHDOG bit not supported");
    expect(crux_system_reset_cause_clear() == CRUX_OK, "cause clear");
    return cause.causes;
}

static void start(crux_watchdog_t *token)
{
    expect(crux_watchdog_start(TIMEOUT_MS, token) == CRUX_OK, "start");
    expect_state(CRUX_WATCHDOG_ACTIVE, "state active");
}

int main(void)
{
    crux_watchdog_t token = {0};
    uint32_t cause = read_and_clear_cause();

    if (cause == CRUX_RESET_CAUSE_SOFTWARE) {
        printk("simwdt: boot 2 cause SOFTWARE, not WATCHDOG\n");
        expect_state(CRUX_WATCHDOG_IDLE, "boot 2 fresh state");
        printk("simwdt: boot 2 fresh state, idle, simulated\n");
        start(&token);
        for (int i = 0; i < FEEDS; ++i) {
            k_msleep(FEED_PERIOD_MS);
            expect(crux_watchdog_feed(token) == CRUX_OK, "boot 2 feed");
        }
        expect_state(CRUX_WATCHDOG_ACTIVE, "boot 2 active after feed cycle");
        printk("simwdt: boot 2 feed cycle ok, no second restart, scenario complete\n");
        for (;;) {
            k_msleep(FEED_PERIOD_MS);
            expect(crux_watchdog_feed(token) == CRUX_OK, "boot 2 feed");
        }
    }

    expect(cause == CRUX_RESET_CAUSE_POR, "boot 1 cause is POR");
    printk("simwdt: boot 1 cause POR\n");
    expect_state(CRUX_WATCHDOG_IDLE, "boot 1 idle");
    printk("simwdt: idle before start, simulated\n");
    start(&token);
    printk("simwdt: started, %d ms, active, simulated\n", TIMEOUT_MS);
    for (int i = 0; i < FEEDS; ++i) {
        k_msleep(FEED_PERIOD_MS);
        expect(crux_watchdog_feed(token) == CRUX_OK, "boot 1 feed");
    }
    expect_state(CRUX_WATCHDOG_ACTIVE, "active after feed cycle");
    printk("simwdt: feed cycle ok, %d feeds over %d ms, no restart\n", FEEDS,
           FEEDS * FEED_PERIOD_MS);
    printk("simwdt: missed feed, no more feeds\n");
    k_sleep(K_FOREVER);
    return 0;
}
```
